// Generated by scripts/build_mobile_ui.py; edit web/index.html instead.
#pragma once
#include <pgmspace.h>
static const char KENNY_WEB_UI[] PROGMEM = R"KENNYHTML(<!doctype html>
<html lang="en">
<head>
<meta charset="utf-8">
<meta name="viewport" content="width=device-width,initial-scale=1,viewport-fit=cover">
<meta name="theme-color" content="#102423">
<title>KENNY · Drive</title>
<style>
:root{color-scheme:dark;--bg:#0b1919;--card:#142827;--line:#284240;--text:#eff8f4;--muted:#a3b8b1;--green:#9ce4bc;--red:#ff7878}
*{box-sizing:border-box}body{margin:0;background:var(--bg);color:var(--text);font:16px system-ui,sans-serif;padding:env(safe-area-inset-top) 18px env(safe-area-inset-bottom);overscroll-behavior:none}main{max-width:880px;margin:0 auto;padding:25px 0}header{display:flex;gap:14px;align-items:center;margin-bottom:24px}.logo{width:45px;height:60px;flex:none}h1{font-size:25px;letter-spacing:.14em;margin:0}header p{margin:3px 0;color:var(--muted);font-size:13px}.badge{margin-left:auto;border:1px solid var(--line);border-radius:30px;padding:8px 12px;font-size:12px;white-space:nowrap}.badge.live{color:var(--green)}.layout{display:grid;gap:18px;grid-template-columns:1.1fr 1fr}.card{background:var(--card);border:1px solid var(--line);border-radius:22px;padding:20px}h2{font-size:16px;margin:0 0 6px}.sub{font-size:13px;color:var(--muted);line-height:1.5;margin:0}.state{display:flex;justify-content:space-between;align-items:center}.pill{font-size:12px;color:var(--muted)}.pad-wrap{position:relative;max-width:310px;margin:15px auto 8px;padding:20px}.direction{position:absolute;color:var(--muted);font-size:10px;letter-spacing:.1em}.forward{top:0;left:50%;transform:translateX(-50%)}.reverse{bottom:0;left:50%;transform:translateX(-50%)}#pad{aspect-ratio:1;border:1px solid #46665d;border-radius:50%;position:relative;touch-action:none;user-select:none;background:radial-gradient(circle,#213f37 0,#172d29 65%);outline:none}#pad::before,#pad::after{content:"";position:absolute;background:#3d5d51;opacity:.55}#pad::before{height:1px;width:100%;top:50%}#pad::after{width:1px;height:100%;left:50%}#pad.active{box-shadow:0 0 0 5px #9ce4bc18;border-color:var(--green)}#knob{position:absolute;left:50%;top:50%;width:76px;height:76px;margin:-38px;border-radius:50%;background:var(--green);color:#123226;display:grid;place-items:center;box-shadow:0 8px 24px #0004;z-index:1;font-size:25px;pointer-events:none}#pad[aria-disabled=true]{opacity:.5}.outputs{display:flex;justify-content:center;gap:28px;margin:14px 0;font-variant-numeric:tabular-nums;font-size:12px;color:var(--muted)}.outputs strong{font-size:19px;color:var(--text);display:block}button{font:inherit;font-weight:650;border:0;border-radius:13px;min-height:50px;padding:12px 18px;cursor:pointer;touch-action:manipulation}button:disabled{opacity:.4;cursor:not-allowed}.arm{background:var(--green);color:#123226;width:100%}.stop{width:100%;margin-top:10px;background:#512b2b;color:#ffd9d9;border:1px solid #9b5151;font-size:19px;letter-spacing:.07em}button:focus-visible,input:focus-visible,#pad:focus-visible{outline:3px solid white;outline-offset:3px}.limit{display:flex;justify-content:space-between;font-size:14px;margin-top:20px}input[type=range]{width:100%;height:36px;accent-color:var(--green);touch-action:pan-y}#message{min-height:42px;font-size:13px;line-height:1.5;color:var(--muted);margin:12px 0 0}#message.error{color:var(--red)}.details{display:grid;gap:18px;align-content:start}.health{display:grid;grid-template-columns:1fr 1fr;gap:12px;margin-top:16px}.metric{padding:12px;border-radius:12px;background:#0d201e;font-size:12px;color:var(--muted)}.metric b{display:block;margin-top:5px;color:var(--text);font-size:15px}table{width:100%;border-collapse:collapse;margin-top:14px;font-size:12px;font-variant-numeric:tabular-nums}th{text-align:left;color:var(--muted);font-weight:500}td,th{padding:10px 3px;border-bottom:1px solid var(--line)}td:not(:first-child),th:not(:first-child){text-align:right}footer{color:var(--muted);font-size:12px;line-height:1.6;margin:18px 4px}.hint{border-left:2px solid var(--green);padding-left:12px;margin-top:14px;font-size:13px;line-height:1.5;color:var(--muted)}@media(max-width:670px){.layout{grid-template-columns:1fr}.card{padding:17px}.pad-wrap{max-width:285px}main{padding-top:16px}.health{grid-template-columns:1fr 1fr}}@media(prefers-reduced-motion:no-preference){#pad{transition:box-shadow .15s}button{transition:opacity .15s}}
</style>
<style>
.scanner{margin-top:18px}.scanner select,.scanner input{max-width:100%;margin:10px 0;padding:8px;background:var(--bg);color:var(--text);border:1px solid var(--line);border-radius:8px}.scan-actions{display:flex;gap:10px;margin:12px 0}.scan-actions button{flex:1}.scanner canvas{width:100%;height:auto;border-radius:12px;background:var(--bg)}.scanner video{display:none}.marker-result{padding:10px 0;border-bottom:1px solid var(--line);font-size:13px;overflow-wrap:anywhere}.marker-result strong{color:var(--green)}
</style>
</head>
<body><main>
<header>
<svg class="logo" viewBox="0 0 60 80" aria-hidden="true"><path d="M30 15V6" stroke="#eff8f4" stroke-width="3"/><circle cx="30" cy="5" r="4" fill="#eff8f4"/><rect x="10" y="16" width="40" height="29" rx="10" fill="#eff8f4"/><circle cx="23" cy="28" r="2.5" fill="#246347"/><circle cx="37" cy="28" r="2.5" fill="#246347"/><rect x="12" y="48" width="36" height="22" rx="7" fill="#b9d8c8"/><path d="M12 56L5 66M48 56L55 66" stroke="#eff8f4" stroke-width="5" stroke-linecap="round"/><circle cx="19" cy="73" r="5" fill="#eff8f4"/><circle cx="41" cy="73" r="5" fill="#eff8f4"/></svg>
<div><h1>KENNY</h1><p id="wiring">Local robot controller</p></div><span id="connection" class="badge" role="status">Connecting…</span>
</header>
<div class="layout">
<section class="card" aria-label="Drive controls">
<div class="state"><h2>Touch to drive</h2><span id="mode" class="pill">DISARMED</span></div>
<p class="sub">Arm, then hold and drag. Release to stop.</p>
<div class="pad-wrap"><span class="direction forward">FORWARD</span>
<div id="pad" role="application" aria-label="Drive joystick: up forward, down reverse, left or right to turn" aria-disabled="true" tabindex="0"><div id="knob">✥</div></div>
<span class="direction reverse">REVERSE</span></div>
<div class="outputs"><span>FORWARD / REVERSE<strong id="linear">0.000 m/s</strong></span><span>TURN<strong id="angular">0.00 rad/s</strong></span></div>
<button class="arm" id="arm" disabled>Arm controller</button>
<button class="stop" id="stop">■ STOP &amp; DISARM</button>
<label class="limit" for="limit"><span>Speed limit</span><strong id="limitValue">50%</strong></label>
<input id="limit" type="range" min="10" max="100" step="5" value="50">
<p class="sub">Maximum: 0.10 m/s · 0.60 rad/s. The slider limits both.</p>
<p id="message" role="status" aria-live="polite">Waiting for the ESP32. Motors start disabled.</p>
</section>
<div class="details">
<section class="card"><h2>Robot status</h2><p class="sub">Live encoder feedback · left/right, front/rear</p>
<div class="health"><div class="metric">Hardware E-stop<b id="estop">—</b></div><div class="metric">Watchdog<b id="watchdog">300 ms</b></div><div class="metric">Controller uptime<b id="uptime">—</b></div><div class="metric">Encoder counts / rev<b id="cpr">—</b></div></div>
<table aria-label="Motor feedback"><thead><tr><th>Wheel</th><th>RPM</th><th>Counts</th><th>PWM</th></tr></thead><tbody id="wheels"><tr><td>Left-front</td><td>—</td><td>—</td><td>—</td></tr><tr><td>Right-front</td><td>—</td><td>—</td><td>—</td></tr><tr><td>Left-rear</td><td>—</td><td>—</td><td>—</td></tr><tr><td>Right-rear</td><td>—</td><td>—</td><td>—</td></tr></tbody></table>
<p id="faults" class="hint">No telemetry yet.</p></section>
<section class="card"><h2>How to connect</h2><p class="sub">Join <strong>KENNY-Robot</strong> Wi-Fi and open <strong>http://192.168.4.1</strong>. Keep this page visible while driving. No internet connection is needed.</p><p class="hint">Leaving this page, losing the link or pressing STOP disarms the robot. Re-arm deliberately to continue. Reverse is enabled for manual control.</p></section>
</div></div>
<section class="card scanner" aria-label="ArUco scanner">
<h2>Scan ArUco · phone camera</h2>
<p class="sub">Read marker ID/value and image coordinates. X increases right, Y increases down from the image’s top-left. Scanning stops and disarms driving.</p>
<label for="dictionary">Marker dictionary</label>
<select id="dictionary"><option value="4,50">DICT_4X4_50</option><option value="4,100">DICT_4X4_100</option><option value="4,250">DICT_4X4_250</option><option value="4,1000">DICT_4X4_1000</option><option value="5,50">DICT_5X5_50</option><option value="5,100">DICT_5X5_100</option><option value="5,250">DICT_5X5_250</option><option value="5,1000">DICT_5X5_1000</option><option value="6,50">DICT_6X6_50</option><option value="6,100">DICT_6X6_100</option><option value="6,250">DICT_6X6_250</option><option value="6,1000">DICT_6X6_1000</option></select>
<div class="scan-actions"><button id="cameraStart">Start live camera</button><button id="cameraStop" disabled>Stop camera</button></div>
<label for="markerPhoto">Take a photo / choose image</label>
<input id="markerPhoto" type="file" accept="image/*" capture="environment">
<p id="scanStatus" class="hint" role="status" aria-live="polite">Choose the dictionary used to print your markers.</p>
<video id="markerVideo" autoplay muted playsinline></video><canvas id="markerCanvas" width="640" height="360" aria-label="Camera image with detected marker outlines"></canvas>
<div id="markerResults" aria-live="polite"></div>
<p class="hint">These are image pixels, not map coordinates or distance in meters. ArUco stores a numeric ID; it does not directly encode a location. Photos are processed locally on your phone.</p>
</section>
<footer>Bench-test with all wheels raised first. STOP removes drive power commands; wheels can coast. This page does not perform obstacle or cliff avoidance.</footer>
</main>
<script>
'use strict';
const $=id=>document.getElementById(id);
const pad=$('pad'),knob=$('knob');
let lease=0,seq=0,epoch=0,arming=false,healthy=false,pointer=null,x=0,y=0,pending=0,polling=false;
let robot=null,boot=null,armedAt=0;
let scannerBusy=false;
const faults=[[1,'Command watchdog expired'],[2,'E-stop contact open'],[4,'Invalid command'],[8,'Encoder motion fault'],[16,'Control-loop timing fault'],[32,'Encoder configuration missing'],[64,'PWM initialization failed'],[128,'MCP23017 / I²C fault — check wiring and restart']];
function message(text,error=false){$('message').textContent=text;$('message').classList.toggle('error',error);}
function buttons(){const ready=healthy&&robot&&robot.ready&&!robot.estop&&!scannerBusy;$('arm').disabled=!ready||!!lease||arming||!!robot.armed;$('arm').textContent=arming?'Arming…':lease?'Armed · hold joystick':'Arm controller';pad.setAttribute('aria-disabled',String(!lease||!healthy));$('mode').textContent=lease?(pointer===null?'READY':'DRIVING'):'DISARMED';}
function draw(){const r=pad.clientWidth/2-40;knob.style.transform=`translate(${x*r}px,${-y*r}px)`;pad.classList.toggle('active',pointer!==null&&!!lease);const s=Number($('limit').value)/100;$('linear').textContent=(y*s*0.1).toFixed(3)+' m/s';$('angular').textContent=(-x*s*0.6).toFixed(2)+' rad/s';buttons();}
async function request(path,body,timeout=220){const abort=new AbortController();const timer=setTimeout(()=>abort.abort(),timeout);try{const response=await fetch(path,{method:body===undefined?'GET':'POST',cache:'no-store',signal:abort.signal,...(body===undefined?{}:{body:new URLSearchParams(body)})});const data=await response.json();if(!response.ok||data.ok===false)throw new Error(data.error||'Command rejected');return data;}finally{clearTimeout(timer);}}
function bestStop(){try{if(navigator.sendBeacon('/api/stop',new URLSearchParams()))return;}catch(_){}fetch('/api/stop',{method:'POST',keepalive:true}).catch(()=>{});}
function disarm(text='Stopped. Press Arm to continue.',notify=true,error=false){++epoch;lease=0;seq=0;arming=false;pointer=null;x=y=0;draw();message(text,error);if(notify)bestStop();}
async function sendDrive(priority=false){if(!lease||!healthy||(pending&&!priority)||document.hidden)return;++pending;const mine=epoch,token=lease;const scale=Number($('limit').value)/100;const v=(y*scale*0.1).toFixed(5),w=(-x*scale*0.6).toFixed(5);try{await request('/api/drive',{lease:token,seq:++seq,v,w});}catch(error){if(epoch===mine)disarm('Control link lost or command rejected. Reconnect and re-arm.',true,true);}finally{--pending;}}
$('arm').addEventListener('click',async()=>{if(arming||lease||!healthy||!robot||!robot.ready||robot.estop)return;const mine=++epoch;arming=true;buttons();try{const data=await request('/api/arm',{},500);if(epoch!==mine||document.hidden){bestStop();return;}lease=data.lease;seq=0;armedAt=performance.now();message('Ready. Hold the joystick to move; release to stop.');await sendDrive();}catch(error){if(epoch===mine)disarm(error.message,true,true);}finally{if(epoch===mine){arming=false;buttons();}}});
$('stop').addEventListener('click',()=>disarm());
function move(event){if(event.pointerId!==pointer)return;const box=pad.getBoundingClientRect();let dx=(event.clientX-box.left-box.width/2)/(box.width/2-38),dy=-(event.clientY-box.top-box.height/2)/(box.height/2-38);const distance=Math.hypot(dx,dy);if(distance>1){dx/=distance;dy/=distance;}const magnitude=Math.hypot(dx,dy);if(magnitude<0.09){dx=dy=0;}else{const gain=(magnitude-0.09)/(0.91*magnitude);dx*=gain;dy*=gain;}x=dx;y=dy;draw();}
pad.addEventListener('pointerdown',event=>{if(!lease||!healthy||pointer!==null||event.button!==0)return;event.preventDefault();pointer=event.pointerId;pad.setPointerCapture(pointer);move(event);sendDrive();});
pad.addEventListener('pointermove',event=>{if(event.pointerId===pointer){event.preventDefault();move(event);}});
pad.addEventListener('pointerup',event=>{if(event.pointerId!==pointer)return;const old=pointer;pointer=null;x=y=0;++epoch;if(pad.hasPointerCapture(old))pad.releasePointerCapture(old);draw();message('Stopped at center. Hold the joystick to drive again.');sendDrive(true);});
pad.addEventListener('pointercancel',event=>{if(event.pointerId===pointer)disarm('Touch interrupted. Re-arm to continue.');});
pad.addEventListener('lostpointercapture',()=>{if(pointer!==null)disarm('Touch capture lost. Re-arm to continue.');});
$('limit').addEventListener('input',()=>{$('limitValue').textContent=$('limit').value+'%';draw();});
window.addEventListener('blur',()=>{if(lease||arming)disarm('Page left. Re-arm to continue.');});
window.addEventListener('pagehide',()=>disarm('Page closed.',true));
document.addEventListener('visibilitychange',()=>{if(document.hidden&&(lease||arming))disarm('Page hidden. Re-arm to continue.');});
window.addEventListener('offline',()=>{healthy=false;disarm('Wi-Fi disconnected.',true,true);});
document.addEventListener('keydown',event=>{if(event.key==='Escape')disarm();});
async function poll(){if(polling||document.hidden)return;polling=true;try{const s=await request('/api/status',undefined,1000);if(boot!==null&&s.boot!==boot)disarm('ESP32 restarted. Re-arm to continue.',false);boot=s.boot;const firstStatus=robot===null;robot=s;healthy=true;if(firstStatus)message(!s.ready?'Hardware not ready. Check wiring selection and controller faults.':s.estop?'Close the E-stop contact before arming.':'Connected. Press Arm, then hold the joystick to drive.');$('wiring').textContent='Local robot controller · '+s.wiring;$('connection').textContent='● Connected';$('connection').classList.add('live');$('estop').textContent=s.estop?'OPEN — STOP':'Closed';$('watchdog').textContent=s.watchdog+' ms';$('uptime').textContent=Math.floor(s.uptime/1000)+' s';$('cpr').textContent=s.cpr;const descriptions=faults.filter(([bit])=>s.faults&bit).map(([,name])=>name);$('faults').textContent=descriptions.length?descriptions.join(' · '):'No controller faults reported.';[...$('wheels').rows].forEach((row,i)=>{row.cells[1].textContent=Number(s.rpm[i]).toFixed(1);row.cells[2].textContent=s.counts[i];row.cells[3].textContent=s.pwm[i];});if(lease&&(s.estop||!s.ready||(!s.armed&&performance.now()-armedAt>350)))disarm('Controller stopped: '+(descriptions.join(', ')||'disarmed'),false,true);buttons();}catch(error){healthy=false;$('connection').textContent='● Offline';$('connection').classList.remove('live');if(lease||arming)disarm('ESP32 connection lost.',true,true);else buttons();}finally{polling=false;}}
setInterval(sendDrive,60);setInterval(poll,500);draw();poll();
</script>
<script>
/*
Copyright (c) 2011 Juan Mellado

Permission is hereby granted, free of charge, to any person obtaining a copy
of this software and associated documentation files (the "Software"), to deal
in the Software without restriction, including without limitation the rights
to use, copy, modify, merge, publish, distribute, sublicense, and/or sell
copies of the Software, and to permit persons to whom the Software is
furnished to do so, subject to the following conditions:

The above copyright notice and this permission notice shall be included in
all copies or substantial portions of the Software.

THE SOFTWARE IS PROVIDED "AS IS", WITHOUT WARRANTY OF ANY KIND, EXPRESS OR
IMPLIED, INCLUDING BUT NOT LIMITED TO THE WARRANTIES OF MERCHANTABILITY,
FITNESS FOR A PARTICULAR PURPOSE AND NONINFRINGEMENT. IN NO EVENT SHALL THE
AUTHORS OR COPYRIGHT HOLDERS BE LIABLE FOR ANY CLAIM, DAMAGES OR OTHER
LIABILITY, WHETHER IN AN ACTION OF CONTRACT, TORT OR OTHERWISE, ARISING FROM,
OUT OF OR IN CONNECTION WITH THE SOFTWARE OR THE USE OR OTHER DEALINGS IN
THE SOFTWARE.
*/

/*
References:
- "OpenCV: Open Computer Vision Library"
  http://sourceforge.net/projects/opencvlibrary/
- "Stack Blur: Fast But Goodlooking"
  http://incubator.quasimondo.com/processing/fast_blur_deluxe.php
*/

var CV = CV || {};
this.CV = CV;

CV.Image = function(width, height, data){
  this.width = width || 0;
  this.height = height || 0;
  this.data = data || [];
};

CV.grayscale = function(imageSrc, imageDst){
  var src = imageSrc.data, dst = imageDst.data, len = src.length,
      i = 0, j = 0;

  for (; i < len; i += 4){
    dst[j ++] =
      (src[i] * 0.299 + src[i + 1] * 0.587 + src[i + 2] * 0.114 + 0.5) & 0xff;
  }

  imageDst.width = imageSrc.width;
  imageDst.height = imageSrc.height;

  return imageDst;
};

CV.threshold = function(imageSrc, imageDst, threshold){
  var src = imageSrc.data, dst = imageDst.data,
      len = src.length, tab = [], i;

  for (i = 0; i < 256; ++ i){
    tab[i] = i <= threshold? 0: 255;
  }

  for (i = 0; i < len; ++ i){
    dst[i] = tab[ src[i] ];
  }

  imageDst.width = imageSrc.width;
  imageDst.height = imageSrc.height;

  return imageDst;
};

CV.adaptiveThreshold = function(imageSrc, imageDst, kernelSize, threshold){
  var src = imageSrc.data, dst = imageDst.data, len = src.length, tab = [], i;

  CV.stackBoxBlur(imageSrc, imageDst, kernelSize);

  for (i = 0; i < 768; ++ i){
    tab[i] = (i - 255 <= -threshold)? 255: 0;
  }

  for (i = 0; i < len; ++ i){
    dst[i] = tab[ src[i] - dst[i] + 255 ];
  }

  imageDst.width = imageSrc.width;
  imageDst.height = imageSrc.height;

  return imageDst;
};

CV.otsu = function(imageSrc){
  var src = imageSrc.data, len = src.length, hist = [],
      threshold = 0, sum = 0, sumB = 0, wB = 0, wF = 0, max = 0,
      mu, between, i;

  for (i = 0; i < 256; ++ i){
    hist[i] = 0;
  }

  for (i = 0; i < len; ++ i){
    hist[ src[i] ] ++;
  }

  for (i = 0; i < 256; ++ i){
    sum += hist[i] * i;
  }

  for (i = 0; i < 256; ++ i){
    wB += hist[i];
    if (0 !== wB){

      wF = len - wB;
      if (0 === wF){
        break;
      }

      sumB += hist[i] * i;

      mu = (sumB / wB) - ( (sum - sumB) / wF );

      between = wB * wF * mu * mu;

      if (between > max){
        max = between;
        threshold = i;
      }
    }
  }

  return threshold;
};

CV.stackBoxBlurMult =
  [1, 171, 205, 293, 57, 373, 79, 137, 241, 27, 391, 357, 41, 19, 283, 265];

CV.stackBoxBlurShift =
  [0, 9, 10, 11, 9, 12, 10, 11, 12, 9, 13, 13, 10, 9, 13, 13];

CV.BlurStack = function(){
  this.color = 0;
  this.next = null;
};

CV.stackBoxBlur = function(imageSrc, imageDst, kernelSize){
  var src = imageSrc.data, dst = imageDst.data,
      height = imageSrc.height, width = imageSrc.width,
      heightMinus1 = height - 1, widthMinus1 = width - 1,
      size = kernelSize + kernelSize + 1, radius = kernelSize + 1,
      mult = CV.stackBoxBlurMult[kernelSize],
      shift = CV.stackBoxBlurShift[kernelSize],
      stack, stackStart, color, sum, pos, start, p, x, y, i;

  stack = stackStart = new CV.BlurStack();
  for (i = 1; i < size; ++ i){
    stack = stack.next = new CV.BlurStack();
  }
  stack.next = stackStart;

  pos = 0;

  for (y = 0; y < height; ++ y){
    start = pos;

    color = src[pos];
    sum = radius * color;

    stack = stackStart;
    for (i = 0; i < radius; ++ i){
      stack.color = color;
      stack = stack.next;
    }
    for (i = 1; i < radius; ++ i){
      stack.color = src[pos + i];
      sum += stack.color;
      stack = stack.next;
    }

    stack = stackStart;
    for (x = 0; x < width; ++ x){
      dst[pos ++] = (sum * mult) >>> shift;

      p = x + radius;
      p = start + (p < widthMinus1? p: widthMinus1);
      sum -= stack.color - src[p];

      stack.color = src[p];
      stack = stack.next;
    }
  }

  for (x = 0; x < width; ++ x){
    pos = x;
    start = pos + width;

    color = dst[pos];
    sum = radius * color;

    stack = stackStart;
    for (i = 0; i < radius; ++ i){
      stack.color = color;
      stack = stack.next;
    }
    for (i = 1; i < radius; ++ i){
      stack.color = dst[start];
      sum += stack.color;
      stack = stack.next;

      start += width;
    }

    stack = stackStart;
    for (y = 0; y < height; ++ y){
      dst[pos] = (sum * mult) >>> shift;

      p = y + radius;
      p = x + ( (p < heightMinus1? p: heightMinus1) * width );
      sum -= stack.color - dst[p];

      stack.color = dst[p];
      stack = stack.next;

      pos += width;
    }
  }

  return imageDst;
};

CV.gaussianBlur = function(imageSrc, imageDst, imageMean, kernelSize){
  var kernel = CV.gaussianKernel(kernelSize);

  imageDst.width = imageSrc.width;
  imageDst.height = imageSrc.height;

  imageMean.width = imageSrc.width;
  imageMean.height = imageSrc.height;

  CV.gaussianBlurFilter(imageSrc, imageMean, kernel, true);
  CV.gaussianBlurFilter(imageMean, imageDst, kernel, false);

  return imageDst;
};

CV.gaussianBlurFilter = function(imageSrc, imageDst, kernel, horizontal){
  var src = imageSrc.data, dst = imageDst.data,
      height = imageSrc.height, width = imageSrc.width,
      pos = 0, limit = kernel.length >> 1,
      cur, value, i, j, k;

  for (i = 0; i < height; ++ i){

    for (j = 0; j < width; ++ j){
      value = 0.0;

      for (k = -limit; k <= limit; ++ k){

        if (horizontal){
          cur = pos + k;
          if (j + k < 0){
            cur = pos;
          }
          else if (j + k >= width){
            cur = pos;
          }
        }else{
          cur = pos + (k * width);
          if (i + k < 0){
            cur = pos;
          }
          else if (i + k >= height){
            cur = pos;
          }
        }

        value += kernel[limit + k] * src[cur];
      }

      dst[pos ++] = horizontal? value: (value + 0.5) & 0xff;
    }
  }

  return imageDst;
};

CV.gaussianKernel = function(kernelSize){
  var tab =
    [ [1],
      [0.25, 0.5, 0.25],
      [0.0625, 0.25, 0.375, 0.25, 0.0625],
      [0.03125, 0.109375, 0.21875, 0.28125, 0.21875, 0.109375, 0.03125] ],
    kernel = [], center, sigma, scale2X, sum, x, i;

  if ( (kernelSize <= 7) && (kernelSize % 2 === 1) ){
    kernel = tab[kernelSize >> 1];
  }else{
    center = (kernelSize - 1.0) * 0.5;
    sigma = 0.8 + (0.3 * (center - 1.0) );
    scale2X = -0.5 / (sigma * sigma);
    sum = 0.0;
    for (i = 0; i < kernelSize; ++ i){
      x = i - center;
      sum += kernel[i] = Math.exp(scale2X * x * x);
    }
    sum = 1 / sum;
    for (i = 0; i < kernelSize; ++ i){
      kernel[i] *= sum;
    }
  }

  return kernel;
};

CV.findContours = function(imageSrc, binary){
  var width = imageSrc.width, height = imageSrc.height, contours = [],
      src, deltas, pos, pix, nbd, outer, hole, i, j;

  src = CV.binaryBorder(imageSrc, binary);

  deltas = CV.neighborhoodDeltas(width + 2);

  pos = width + 3;
  nbd = 1;

  for (i = 0; i < height; ++ i, pos += 2){

    for (j = 0; j < width; ++ j, ++ pos){
      pix = src[pos];

      if (0 !== pix){
        outer = hole = false;

        if (1 === pix && 0 === src[pos - 1]){
          outer = true;
        }
        else if (pix >= 1 && 0 === src[pos + 1]){
          hole = true;
        }

        if (outer || hole){
          ++ nbd;

          contours.push( CV.borderFollowing(src, pos, nbd, {x: j, y: i}, hole, deltas) );
        }
      }
    }
  }

  return contours;
};

CV.borderFollowing = function(src, pos, nbd, point, hole, deltas){
  var contour = [], pos1, pos3, pos4, s, s_end, s_prev;

  contour.hole = hole;

  s = s_end = hole? 0: 4;
  do{
    s = (s - 1) & 7;
    pos1 = pos + deltas[s];
    if (src[pos1] !== 0){
      break;
    }
  }while(s !== s_end);

  if (s === s_end){
    src[pos] = -nbd;
    contour.push( {x: point.x, y: point.y} );

  }else{
    pos3 = pos;
    s_prev = s ^ 4;

    while(true){
      s_end = s;

      do{
        pos4 = pos3 + deltas[++ s];
      }while(src[pos4] === 0);

      s &= 7;

      if ( ( (s - 1) >>> 0) < (s_end >>> 0) ){
        src[pos3] = -nbd;
      }
      else if (src[pos3] === 1){
        src[pos3] = nbd;
      }

      contour.push( {x: point.x, y: point.y} );

      s_prev = s;

      point.x += CV.neighborhood[s][0];
      point.y += CV.neighborhood[s][1];

      if ( (pos4 === pos) && (pos3 === pos1) ){
        break;
      }

      pos3 = pos4;
      s = (s + 4) & 7;
    }
  }

  return contour;
};

CV.neighborhood =
  [ [1, 0], [1, -1], [0, -1], [-1, -1], [-1, 0], [-1, 1], [0, 1], [1, 1] ];

CV.neighborhoodDeltas = function(width){
  var deltas = [], len = CV.neighborhood.length, i = 0;

  for (; i < len; ++ i){
    deltas[i] = CV.neighborhood[i][0] + (CV.neighborhood[i][1] * width);
  }

  return deltas.concat(deltas);
};

CV.approxPolyDP = function(contour, epsilon){
  var slice = {start_index: 0, end_index: 0},
      right_slice = {start_index: 0, end_index: 0},
      poly = [], stack = [], len = contour.length,
      pt, start_pt, end_pt, dist, max_dist, le_eps,
      dx, dy, i, j, k;

  epsilon *= epsilon;

  k = 0;

  for (i = 0; i < 3; ++ i){
    max_dist = 0;

    k = (k + right_slice.start_index) % len;
    start_pt = contour[k];
    if (++ k === len) {k = 0;}

    for (j = 1; j < len; ++ j){
      pt = contour[k];
      if (++ k === len) {k = 0;}

      dx = pt.x - start_pt.x;
      dy = pt.y - start_pt.y;
      dist = dx * dx + dy * dy;

      if (dist > max_dist){
        max_dist = dist;
        right_slice.start_index = j;
      }
    }
  }

  if (max_dist <= epsilon){
    poly.push( {x: start_pt.x, y: start_pt.y} );

  }else{
    slice.start_index = k;
    slice.end_index = (right_slice.start_index += slice.start_index);

    right_slice.start_index -= right_slice.start_index >= len? len: 0;
    right_slice.end_index = slice.start_index;
    if (right_slice.end_index < right_slice.start_index){
      right_slice.end_index += len;
    }

    stack.push( {start_index: right_slice.start_index, end_index: right_slice.end_index} );
    stack.push( {start_index: slice.start_index, end_index: slice.end_index} );
  }

  while(stack.length !== 0){
    slice = stack.pop();

    end_pt = contour[slice.end_index % len];
    start_pt = contour[k = slice.start_index % len];
    if (++ k === len) {k = 0;}

    if (slice.end_index <= slice.start_index + 1){
      le_eps = true;

    }else{
      max_dist = 0;

      dx = end_pt.x - start_pt.x;
      dy = end_pt.y - start_pt.y;

      for (i = slice.start_index + 1; i < slice.end_index; ++ i){
        pt = contour[k];
        if (++ k === len) {k = 0;}

        dist = Math.abs( (pt.y - start_pt.y) * dx - (pt.x - start_pt.x) * dy);

        if (dist > max_dist){
          max_dist = dist;
          right_slice.start_index = i;
        }
      }

      le_eps = max_dist * max_dist <= epsilon * (dx * dx + dy * dy);
    }

    if (le_eps){
      poly.push( {x: start_pt.x, y: start_pt.y} );

    }else{
      right_slice.end_index = slice.end_index;
      slice.end_index = right_slice.start_index;

      stack.push( {start_index: right_slice.start_index, end_index: right_slice.end_index} );
      stack.push( {start_index: slice.start_index, end_index: slice.end_index} );
    }
  }

  return poly;
};

CV.warp = function(imageSrc, imageDst, contour, warpSize){
  var src = imageSrc.data, dst = imageDst.data,
      width = imageSrc.width, height = imageSrc.height,
      pos = 0,
      sx1, sx2, dx1, dx2, sy1, sy2, dy1, dy2, p1, p2, p3, p4,
      m, r, s, t, u, v, w, x, y, i, j;

  m = CV.getPerspectiveTransform(contour, warpSize - 1);

  r = m[8];
  s = m[2];
  t = m[5];

  for (i = 0; i < warpSize; ++ i){
    r += m[7];
    s += m[1];
    t += m[4];

    u = r;
    v = s;
    w = t;

    for (j = 0; j < warpSize; ++ j){
      u += m[6];
      v += m[0];
      w += m[3];

      x = v / u;
      y = w / u;

      sx1 = x >>> 0;
      sx2 = (sx1 === width - 1)? sx1: sx1 + 1;
      dx1 = x - sx1;
      dx2 = 1.0 - dx1;

      sy1 = y >>> 0;
      sy2 = (sy1 === height - 1)? sy1: sy1 + 1;
      dy1 = y - sy1;
      dy2 = 1.0 - dy1;

      p1 = p2 = sy1 * width;
      p3 = p4 = sy2 * width;

      dst[pos ++] =
        (dy2 * (dx2 * src[p1 + sx1] + dx1 * src[p2 + sx2]) +
         dy1 * (dx2 * src[p3 + sx1] + dx1 * src[p4 + sx2]) ) & 0xff;

    }
  }

  imageDst.width = warpSize;
  imageDst.height = warpSize;

  return imageDst;
};

CV.getPerspectiveTransform = function(src, size){
  var rq = CV.square2quad(src);

  rq[0] /= size;
  rq[1] /= size;
  rq[3] /= size;
  rq[4] /= size;
  rq[6] /= size;
  rq[7] /= size;

  return rq;
};

CV.square2quad = function(src){
  var sq = [], px, py, dx1, dx2, dy1, dy2, den;

  px = src[0].x - src[1].x + src[2].x - src[3].x;
  py = src[0].y - src[1].y + src[2].y - src[3].y;

  if (0 === px && 0 === py){
    sq[0] = src[1].x - src[0].x;
    sq[1] = src[2].x - src[1].x;
    sq[2] = src[0].x;
    sq[3] = src[1].y - src[0].y;
    sq[4] = src[2].y - src[1].y;
    sq[5] = src[0].y;
    sq[6] = 0;
    sq[7] = 0;
    sq[8] = 1;

  }else{
    dx1 = src[1].x - src[2].x;
    dx2 = src[3].x - src[2].x;
    dy1 = src[1].y - src[2].y;
    dy2 = src[3].y - src[2].y;
    den = dx1 * dy2 - dx2 * dy1;

    sq[6] = (px * dy2 - dx2 * py) / den;
    sq[7] = (dx1 * py - px * dy1) / den;
    sq[8] = 1;
    sq[0] = src[1].x - src[0].x + sq[6] * src[1].x;
    sq[1] = src[3].x - src[0].x + sq[7] * src[3].x;
    sq[2] = src[0].x;
    sq[3] = src[1].y - src[0].y + sq[6] * src[1].y;
    sq[4] = src[3].y - src[0].y + sq[7] * src[3].y;
    sq[5] = src[0].y;
  }

  return sq;
};

CV.isContourConvex = function(contour){
  var orientation = 0, convex = true,
      len = contour.length, i = 0, j = 0,
      cur_pt, prev_pt, dxdy0, dydx0, dx0, dy0, dx, dy;

  prev_pt = contour[len - 1];
  cur_pt = contour[0];

  dx0 = cur_pt.x - prev_pt.x;
  dy0 = cur_pt.y - prev_pt.y;

  for (; i < len; ++ i){
    if (++ j === len) {j = 0;}

    prev_pt = cur_pt;
    cur_pt = contour[j];

    dx = cur_pt.x - prev_pt.x;
    dy = cur_pt.y - prev_pt.y;
    dxdy0 = dx * dy0;
    dydx0 = dy * dx0;

    orientation |= dydx0 > dxdy0? 1: (dydx0 < dxdy0? 2: 3);

    if (3 === orientation){
        convex = false;
        break;
    }

    dx0 = dx;
    dy0 = dy;
  }

  return convex;
};

CV.perimeter = function(poly){
  var len = poly.length, i = 0, j = len - 1,
      p = 0.0, dx, dy;

  for (; i < len; j = i ++){
    dx = poly[i].x - poly[j].x;
    dy = poly[i].y - poly[j].y;

    p += Math.sqrt(dx * dx + dy * dy) ;
  }

  return p;
};

CV.minEdgeLength = function(poly){
  var len = poly.length, i = 0, j = len - 1,
      min = Infinity, d, dx, dy;

  for (; i < len; j = i ++){
    dx = poly[i].x - poly[j].x;
    dy = poly[i].y - poly[j].y;

    d = dx * dx + dy * dy;

    if (d < min){
      min = d;
    }
  }

  return Math.sqrt(min);
};

CV.countNonZero = function(imageSrc, square){
  var src = imageSrc.data, height = square.height, width = square.width,
      pos = square.x + (square.y * imageSrc.width),
      span = imageSrc.width - width,
      nz = 0, i, j;

  for (i = 0; i < height; ++ i){

    for (j = 0; j < width; ++ j){

      if ( 0 !== src[pos ++] ){
        ++ nz;
      }
    }

    pos += span;
  }

  return nz;
};

CV.binaryBorder = function(imageSrc, dst){
  var src = imageSrc.data, height = imageSrc.height, width = imageSrc.width,
      posSrc = 0, posDst = 0, i, j;

  for (j = -2; j < width; ++ j){
    dst[posDst ++] = 0;
  }

  for (i = 0; i < height; ++ i){
    dst[posDst ++] = 0;

    for (j = 0; j < width; ++ j){
      dst[posDst ++] = (0 === src[posSrc ++]? 0: 1);
    }

    dst[posDst ++] = 0;
  }

  for (j = -2; j < width; ++ j){
    dst[posDst ++] = 0;
  }

  return dst;
};

</script>
<script>
/*
Copyright (c) 2020 Damiano Falcioni
Copyright (c) 2011 Juan Mellado

Permission is hereby granted, free of charge, to any person obtaining a copy
of this software and associated documentation files (the "Software"), to deal
in the Software without restriction, including without limitation the rights
to use, copy, modify, merge, publish, distribute, sublicense, and/or sell
copies of the Software, and to permit persons to whom the Software is
furnished to do so, subject to the following conditions:

The above copyright notice and this permission notice shall be included in
all copies or substantial portions of the Software.

THE SOFTWARE IS PROVIDED "AS IS", WITHOUT WARRANTY OF ANY KIND, EXPRESS OR
IMPLIED, INCLUDING BUT NOT LIMITED TO THE WARRANTIES OF MERCHANTABILITY,
FITNESS FOR A PARTICULAR PURPOSE AND NONINFRINGEMENT. IN NO EVENT SHALL THE
AUTHORS OR COPYRIGHT HOLDERS BE LIABLE FOR ANY CLAIM, DAMAGES OR OTHER
LIABILITY, WHETHER IN AN ACTION OF CONTRACT, TORT OR OTHERWISE, ARISING FROM,
OUT OF OR IN CONNECTION WITH THE SOFTWARE OR THE USE OR OTHER DEALINGS IN
THE SOFTWARE.
*/

/*
References:
- "ArUco: a minimal library for Augmented Reality applications based on OpenCv"
  http://www.uco.es/investiga/grupos/ava/node/26
- "js-aruco: a port to JavaScript of the ArUco library"
  https://github.com/jcmellado/js-aruco
*/

var AR = {};
var CV = this.CV || require('./cv').CV;
this.AR = AR;

AR.DICTIONARIES = {
  ARUCO: {
    nBits: 25,
    tau: 3,
    codeList: [0x1084210,0x1084217,0x1084209,0x108420e,0x10842f0,0x10842f7,0x10842e9,0x10842ee,0x1084130,0x1084137,0x1084129,0x108412e,0x10841d0,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0xe739d7,0xe739c9]
  },
  ARUCO_MIP_36h12: {
    nBits: 36,
    tau: 12,
    codeList: [0xd2b63a09d,0x6001134e5,0x1206fbe72,0xff8ad6cb4,0x85da9bc49,0xb461afe9c,0x6db51fe13,0x5248c541f,0x8f34503,0x8ea462ece,0xeac2be76d,0x1af615c44,0xb48a49f27,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0x7075f1c04,0x4d58dbea0]
  }
};

AR.Dictionary = function (dicName) {
  this.codes = {};
  this.codeList = [];
  this.tau = 0;
  this._initialize(dicName);
};

AR.Dictionary.prototype._initialize = function (dicName) {
  this.codes = {};
  this.codeList = [];
  this.tau = 0;
  this.nBits = 0;
  this.markSize = 0;
  this.dicName = dicName;
  var dictionary = AR.DICTIONARIES[dicName];
  if (!dictionary)
    throw 'The dictionary "' + dicName + '" is not recognized.';
  
  this.nBits = dictionary.nBits;
  this.markSize = Math.sqrt(dictionary.nBits) + 2;
  for (var i = 0; i < dictionary.codeList.length; i++) {
    var code = null;
    if (typeof dictionary.codeList[i] === 'number')
      code = this._hex2bin(dictionary.codeList[i], dictionary.nBits);
    if (typeof dictionary.codeList[i] === 'string')
      code = this._hex2bin(parseInt(dictionary.codeList[i], 16), dictionary.nBits);
    if (Array.isArray(dictionary.codeList[i])) 
      code = this._bytes2bin(dictionary.codeList[i], dictionary.nBits);
    if (code === null) 
      throw 'Invalid code ' + i + ' in dictionary ' + dicName + ': ' + JSON.stringify(dictionary.codeList[i]);
    if (code.length != dictionary.nBits)
      throw 'The code ' + i + ' in dictionary ' + dicName + ' is not ' +  dictionary.nBits + ' bits long but ' + code.length + ': ' + code;
    this.codeList.push(code);
    this.codes[code] = {
      id: i
    };
  }
  this.tau = dictionary.tau || this._calculateTau();
};

AR.Dictionary.prototype.find = function (bits) {
  var val = '',
    i, j;
  for (i = 0; i < bits.length; i++) {
    var bitRow = bits[i];
    for (j = 0; j < bitRow.length; j++) {
      val += bitRow[j];
    }
  }
  var minFound = this.codes[val];
  if (minFound)
    return {
      id: minFound.id,
      distance: 0
    };

  for (i = 0; i < this.codeList.length; i++) {
    var code = this.codeList[i];
    var distance = this._hammingDistance(val, code);
    if (this._hammingDistance(val, code) < this.tau) {
      if (!minFound || minFound.distance > distance) {
        minFound = {
          id: this.codes[code].id,
          distance: distance
        };
      }
    }
  }
  return minFound;
};

AR.Dictionary.prototype._hex2bin = function (hex, nBits) {
  return hex.toString(2).padStart(nBits, '0');
};

AR.Dictionary.prototype._bytes2bin = function (byteList, nBits) {
  var bits = '', byte;
  for (byte of byteList) {
    bits += byte.toString(2).padStart(bits.length + 8 > nBits?nBits - bits.length:8, '0');
  }
  return bits;
};

AR.Dictionary.prototype._hammingDistance = function (str1, str2) {
  if (str1.length != str2.length)
    throw 'Hamming distance calculation require inputs of the same length';
  var distance = 0,
    i;
  for (i = 0; i < str1.length; i++)
    if (str1[i] !== str2[i])
      distance += 1;
  return distance;
};

AR.Dictionary.prototype._calculateTau = function () {
  var tau = Number.MAX_VALUE;
  for(var i=0;i<this.codeList.length;i++)
    for(var j=i+1;j<this.codeList.length;j++) {
      var distance = this._hammingDistance(this.codeList[i], this.codeList[j]);
      tau = distance < tau ? distance : tau;
    }
  return tau;
};

AR.Dictionary.prototype.generateSVG = function (id) {
  var code = this.codeList[id];
  if (code == null)
    throw 'The id "' + id + '" is not valid for the dictionary "' + this.dicName + '". ID must be between 0 and ' + (this.codeList.length-1) + ' included.';
  var size = this.markSize - 2;
  var svg = '<svg xmlns="http://www.w3.org/2000/svg" viewBox="0 0 '+ (size+4) + ' ' + (size+4) + '">';
  svg += '<rect x="0" y="0" width="' + (size+4) + '" height="' + (size+4) + '" fill="white"/>';
  svg += '<rect x="1" y="1" width="' + (size+2) + '" height="' + (size+2) + '" fill="black"/>';
  for(var y=0;y<size;y++) {
    for(var x=0;x<size;x++) {
      if (code[y*size+x]=='1') 
        svg += '<rect x="' + (x+2) + '" y="' + (y+2) + '" width="1" height="1" fill="white"/>';
    }
  }
  svg += '</svg>';
  return svg;
};

AR.Marker = function (id, corners, hammingDistance) {
  this.id = id;
  this.corners = corners;
  this.hammingDistance = hammingDistance;
};

AR.Detector = function (config) {
  config = config || {};
  this.grey = new CV.Image();
  this.thres = new CV.Image();
  this.homography = new CV.Image();
  this.binary = [];
  this.contours = [];
  this.polys = [];
  this.candidates = [];
  config.dictionaryName = config.dictionaryName || 'ARUCO_MIP_36h12';
  this.dictionary = new AR.Dictionary(config.dictionaryName);
  this.dictionary.tau = config.maxHammingDistance != null ? config.maxHammingDistance : this.dictionary.tau;
};

AR.Detector.prototype.detectImage = function (width, height, data) {
  return this.detect({
    width: width,
    height: height,
    data: data
  });
};

AR.Detector.prototype.detectStreamInit = function (width, height, callback) {
  this.streamConfig = {};
  this.streamConfig.width = width;
  this.streamConfig.height = height;
  this.streamConfig.imageSize = width * height * 4; //provided image must be a sequence of rgba bytes (4 bytes represent a pixel)
  this.streamConfig.index = 0;
  this.streamConfig.imageData = new Uint8ClampedArray(this.streamConfig.imageSize);
  this.streamConfig.callback = callback || function (image, markerList) {};
};

//accept data chunks of different sizes
AR.Detector.prototype.detectStream = function (data) {
  for (var i = 0; i < data.length; i++) {
    this.streamConfig.imageData[this.streamConfig.index] = data[i];
    this.streamConfig.index = (this.streamConfig.index + 1) % this.streamConfig.imageSize;
    if (this.streamConfig.index == 0) {
      var image = {
        width: this.streamConfig.width,
        height: this.streamConfig.height,
        data: this.streamConfig.imageData
      };
      var markerList = this.detect(image);
      this.streamConfig.callback(image, markerList);
    }
  }
};

AR.Detector.prototype.detectMJPEGStreamInit = function (width, height, callback, decoderFn) {
  this.mjpeg = {
    decoderFn: decoderFn,
    chunks: [],
    SOI: [0xff, 0xd8],
    EOI: [0xff, 0xd9]
  };
  this.detectStreamInit(width, height, callback);
};

AR.Detector.prototype.detectMJPEGStream = function (chunk) {
  var eoiPos = chunk.findIndex(function (element, index, array) {
    return this.mjpeg.EOI[0] == element && array.length > index + 1 && this.mjpeg.EOI[1] == array[index + 1];
  });
  var soiPos = chunk.findIndex(function (element, index, array) {
    return this.mjpeg.SOI[0] == element && array.length > index + 1 && this.mjpeg.SOI[1] == array[index + 1];
  });

  if (eoiPos === -1) {
    this.mjpeg.chunks.push(chunk);
  } else {
    var part1 = chunk.slice(0, eoiPos + 2);
    if (part1.length) {
      this.mjpeg.chunks.push(part1);
    }
    if (this.mjpeg.chunks.length) {
      var jpegImage = this.mjpeg.chunks.flat();
      var rgba = this.mjpeg.decoderFn(jpegImage);
      this.detectStream(rgba);
    }
    this.mjpeg.chunks = [];
  }
  if (soiPos > -1) {
    this.mjpeg.chunks = [];
    this.mjpeg.chunks.push(chunk.slice(soiPos));
  }
};

AR.Detector.prototype.detect = function (image) {
  CV.grayscale(image, this.grey);
  CV.adaptiveThreshold(this.grey, this.thres, 2, 7);

  this.contours = CV.findContours(this.thres, this.binary);
  //Scale Fix: https://stackoverflow.com/questions/35936397/marker-detection-on-paper-sheet-using-javascript
  //this.candidates = this.findCandidates(this.contours, image.width * 0.20, 0.05, 10);
  this.candidates = this.findCandidates(this.contours, image.width * 0.01, 0.05, 10);
  this.candidates = this.clockwiseCorners(this.candidates);
  this.candidates = this.notTooNear(this.candidates, 10);

  return this.findMarkers(this.grey, this.candidates, 49);
};

AR.Detector.prototype.findCandidates = function (contours, minSize, epsilon, minLength) {
  var candidates = [],
    len = contours.length,
    contour, poly, i;

  this.polys = [];

  for (i = 0; i < len; ++i) {
    contour = contours[i];

    if (contour.length >= minSize) {
      poly = CV.approxPolyDP(contour, contour.length * epsilon);

      this.polys.push(poly);

      if ((4 === poly.length) && (CV.isContourConvex(poly))) {

        if (CV.minEdgeLength(poly) >= minLength) {
          candidates.push(poly);
        }
      }
    }
  }

  return candidates;
};

AR.Detector.prototype.clockwiseCorners = function (candidates) {
  var len = candidates.length,
    dx1, dx2, dy1, dy2, swap, i;

  for (i = 0; i < len; ++i) {
    dx1 = candidates[i][1].x - candidates[i][0].x;
    dy1 = candidates[i][1].y - candidates[i][0].y;
    dx2 = candidates[i][2].x - candidates[i][0].x;
    dy2 = candidates[i][2].y - candidates[i][0].y;

    if ((dx1 * dy2 - dy1 * dx2) < 0) {
      swap = candidates[i][1];
      candidates[i][1] = candidates[i][3];
      candidates[i][3] = swap;
    }
  }

  return candidates;
};

AR.Detector.prototype.notTooNear = function (candidates, minDist) {
  var notTooNear = [],
    len = candidates.length,
    dist, dx, dy, i, j, k;

  for (i = 0; i < len; ++i) {

    for (j = i + 1; j < len; ++j) {
      dist = 0;

      for (k = 0; k < 4; ++k) {
        dx = candidates[i][k].x - candidates[j][k].x;
        dy = candidates[i][k].y - candidates[j][k].y;

        dist += dx * dx + dy * dy;
      }

      if ((dist / 4) < (minDist * minDist)) {

        if (CV.perimeter(candidates[i]) < CV.perimeter(candidates[j])) {
          candidates[i].tooNear = true;
        } else {
          candidates[j].tooNear = true;
        }
      }
    }
  }

  for (i = 0; i < len; ++i) {
    if (!candidates[i].tooNear) {
      notTooNear.push(candidates[i]);
    }
  }

  return notTooNear;
};

AR.Detector.prototype.findMarkers = function (imageSrc, candidates, warpSize) {
  var markers = [],
    len = candidates.length,
    candidate, marker, i;

  for (i = 0; i < len; ++i) {
    candidate = candidates[i];

    CV.warp(imageSrc, this.homography, candidate, warpSize);

    CV.threshold(this.homography, this.homography, CV.otsu(this.homography));

    marker = this.getMarker(this.homography, candidate);
    if (marker) {
      markers.push(marker);
    }
  }

  return markers;
};

AR.Detector.prototype.getMarker = function (imageSrc, candidate) {
  var markSize = this.dictionary.markSize;
  var width = (imageSrc.width / markSize) >>> 0,
    minZero = (width * width) >> 1,
    bits = [],
    rotations = [],
    square, inc, i, j;

  for (i = 0; i < markSize; ++i) {
    inc = (0 === i || (markSize - 1) === i) ? 1 : (markSize - 1);

    for (j = 0; j < markSize; j += inc) {
      square = {
        x: j * width,
        y: i * width,
        width: width,
        height: width
      };
      if (CV.countNonZero(imageSrc, square) > minZero) {
        return null;
      }
    }
  }

  for (i = 0; i < markSize - 2; ++i) {
    bits[i] = [];

    for (j = 0; j < markSize - 2; ++j) {
      square = {
        x: (j + 1) * width,
        y: (i + 1) * width,
        width: width,
        height: width
      };

      bits[i][j] = CV.countNonZero(imageSrc, square) > minZero ? 1 : 0;
    }
  }

  rotations[0] = bits;

  var foundMin = null;
  var rot = 0;
  for (i = 0; i < 4; i++) {
    var found = this.dictionary.find(rotations[i]);
    if (found && (foundMin === null || found.distance < foundMin.distance)) {
      foundMin = found;
      rot = i;
      if (foundMin.distance === 0)
        break;
    }
    rotations[i + 1] = this.rotate(rotations[i]);
  }

  if (foundMin)
    return new AR.Marker(foundMin.id, this.rotate2(candidate, 4 - rot), foundMin.distance);

  return null;
};

AR.Detector.prototype.rotate = function (src) {
  var dst = [],
    len = src.length,
    i, j;

  for (i = 0; i < len; ++i) {
    dst[i] = [];
    for (j = 0; j < src[i].length; ++j) {
      dst[i][j] = src[src[i].length - j - 1][i];
    }
  }

  return dst;
};

AR.Detector.prototype.rotate2 = function (src, rotation) {
  var dst = [],
    len = src.length,
    i;

  for (i = 0; i < len; ++i) {
    dst[i] = src[(rotation + i) % len];
  }

  return dst;
};

</script>
<script>
/*
By downloading, copying, installing or using the software you agree to this
license. If you do not agree to this license, do not download, install,
copy or use the software.
                          License Agreement
               For Open Source Computer Vision Library
                       (3-clause BSD License)
Copyright (C) 2013, OpenCV Foundation, all rights reserved.
Third party copyrights are property of their respective owners.
Redistribution and use in source and binary forms, with or without modification,
are permitted provided that the following conditions are met:
  * Redistributions of source code must retain the above copyright notice,
    this list of conditions and the following disclaimer.
  * Redistributions in binary form must reproduce the above copyright notice,
    this list of conditions and the following disclaimer in the documentation
    and/or other materials provided with the distribution.
  * Neither the names of the copyright holders nor the names of the contributors
    may be used to endorse or promote products derived from this software
    without specific prior written permission.
This software is provided by the copyright holders and contributors "as is" and
any express or implied warranties, including, but not limited to, the implied
warranties of merchantability and fitness for a particular purpose are
disclaimed. In no event shall copyright holders or contributors be liable for
any direct, indirect, incidental, special, exemplary, or consequential damages
(including, but not limited to, procurement of substitute goods or services;
loss of use, data, or profits; or business interruption) however caused
and on any theory of liability, whether in contract, strict liability,
or tort (including negligence or otherwise) arising in any way out of
the use of this software, even if advised of the possibility of such damage.
*/

//Dictionary extracted from https://github.com/opencv/opencv_contrib/blob/4.x/modules/aruco/src/predefined_dictionaries.hpp

var AR = this.AR || require('../aruco').AR;
AR.DICTIONARIES['ARUCO_4X4_1000'] = {
  nBits: 16,
  tau: null,
  codeList: [[181,50],[15,154],[51,45],[153,70],[84,158],[121,205],[158,46],[196,242],[254,218],[207,86],[249,145],[17,167],[14,183],[42,15],[36,177],[38,62],[70,101],[102,0],[108,94],[118,175],[134,139],[176,43],[204,213],[221,130],[254,71],[148,113],[172,228],[165,84],[33,35],[52,111],[68,21],[87,178],[158,207],[240,203],[8,174],[9,41],[24,117],[4,255],[13,246],[28,90],[23,24],[42,40],[50,140],[56,178],[36,232],[46,235],[45,63],[75,100],[80,46],[80,19],[81,148],[85,104],[93,65],[95,151],[104,1],[104,103],[97,36],[97,233],[107,18],[111,229],[103,223],[126,27],[128,160],[131,68],[139,162],[147,122],[132,108],[133,42],[133,156],[156,137],[159,161],[187,124],[188,4],[182,91],[191,200],[183,171],[202,31],[201,98],[217,88],[211,213],[204,152],[199,160],[197,55],[233,93],[249,37],[251,187],[238,42],[247,77],[53,117],[138,173],[118,23],[10,207],[6,75],[45,193],[73,216],[67,244],[79,54],[79,211],[105,228],[112,199],[122,110],[180,234],[237,79],[252,231],[254,166],[0,37],[0,67],[10,136],[10,134],[2,111],[0,28],[0,151],[8,55],[10,49],[9,198],[11,1],[9,251],[11,88],[16,130],[24,45],[16,120],[16,115],[18,116],[18,177],[26,249],[19,6],[12,14],[12,241],[4,51],[12,159],[14,242],[14,253],[7,76],[15,164],[7,47],[5,181],[15,145],[7,219],[30,228],[20,57],[29,128],[21,200],[31,139],[21,186],[29,177],[32,128],[40,233],[34,162],[40,83],[42,240],[34,247],[41,64],[33,70],[41,185],[43,156],[43,178],[56,202],[56,46],[48,7],[56,231],[58,73],[58,101],[50,93],[59,136],[57,29],[59,211],[38,71],[39,128],[47,170],[45,20],[37,222],[37,83],[47,119],[52,72],[60,168],[60,65],[52,13],[52,251],[54,154],[61,224],[53,106],[61,9],[61,237],[63,196],[63,108],[55,206],[61,92],[61,118],[55,176],[63,23],[63,255],[72,229],[66,104],[74,45],[65,96],[73,81],[65,221],[75,223],[88,79],[90,72],[88,22],[80,93],[90,250],[90,181],[81,35],[91,138],[89,25],[81,53],[76,105],[70,193],[78,11],[68,95],[78,89],[77,131],[77,125],[71,216],[71,115],[92,133],[94,68],[86,43],[92,187],[85,195],[95,110],[95,235],[93,18],[85,94],[98,112],[98,21],[97,194],[107,32],[99,69],[107,92],[107,91],[120,12],[122,207],[120,127],[121,128],[113,229],[113,116],[121,182],[113,211],[123,51],[100,106],[102,168],[110,167],[110,145],[101,34],[109,203],[103,141],[109,49],[126,128],[126,226],[126,141],[116,210],[124,50],[126,53],[117,171],[119,5],[127,43],[125,218],[127,146],[128,117],[128,243],[129,166],[137,237],[129,252],[152,166],[154,32],[145,67],[153,249],[145,147],[155,212],[132,9],[132,107],[134,196],[142,100],[134,26],[133,78],[141,203],[133,103],[133,175],[133,215],[135,179],[156,225],[156,242],[148,23],[149,0],[149,162],[157,35],[159,98],[157,82],[149,218],[160,197],[170,205],[162,216],[162,87],[169,61],[169,87],[171,82],[163,54],[163,89],[176,244],[184,18],[176,191],[178,157],[187,237],[185,114],[185,150],[164,195],[172,210],[174,177],[165,130],[175,101],[165,123],[175,250],[180,100],[188,98],[180,129],[182,160],[190,238],[190,13],[188,217],[190,248],[181,40],[183,9],[183,210],[192,234],[192,25],[192,253],[200,211],[202,90],[193,77],[201,180],[193,87],[195,152],[195,29],[216,128],[216,239],[218,43],[208,30],[209,5],[211,173],[219,167],[196,201],[204,120],[205,69],[197,11],[207,207],[220,172],[212,2],[220,99],[212,39],[212,245],[214,120],[222,184],[221,230],[213,93],[221,189],[223,29],[226,202],[234,107],[224,180],[226,56],[226,212],[227,34],[225,216],[240,3],[242,204],[248,246],[241,73],[243,234],[241,156],[249,245],[241,59],[236,141],[238,201],[230,15],[228,247],[231,96],[239,232],[237,178],[229,21],[239,209],[244,134],[252,1],[246,195],[244,124],[252,147],[245,66],[253,152],[245,61],[2,189],[0,225],[2,226],[2,174],[8,120],[0,116],[8,158],[8,209],[8,125],[10,50],[10,222],[2,81],[1,162],[3,128],[11,131],[11,75],[11,39],[11,239],[9,182],[9,89],[9,147],[11,248],[3,217],[3,241],[16,196],[24,171],[26,160],[26,4],[26,108],[26,174],[18,137],[16,23],[26,243],[25,64],[17,2],[17,43],[17,207],[27,34],[19,46],[17,21],[19,187],[12,32],[12,201],[12,220],[12,54],[6,20],[6,114],[13,97],[5,13],[13,143],[15,224],[15,73],[7,133],[5,144],[13,51],[15,150],[15,118],[20,96],[28,141],[20,218],[28,115],[30,148],[30,186],[22,217],[30,61],[22,251],[29,233],[29,254],[31,159],[40,139],[32,175],[34,14],[34,169],[42,141],[42,163],[42,239],[40,144],[40,59],[42,88],[34,51],[33,160],[33,2],[33,165],[33,199],[43,3],[35,103],[41,48],[41,210],[43,25],[43,155],[43,151],[56,40],[56,165],[58,134],[50,1],[56,159],[50,210],[58,153],[58,213],[57,232],[59,193],[51,67],[59,231],[49,154],[51,144],[59,158],[36,196],[44,74],[44,173],[44,207],[44,103],[38,234],[46,229],[44,112],[46,18],[46,209],[46,57],[37,100],[37,231],[47,204],[45,188],[45,113],[37,213],[37,155],[39,16],[47,124],[39,242],[39,58],[47,182],[39,211],[47,179],[39,31],[60,75],[54,192],[54,238],[62,233],[52,184],[60,20],[60,82],[52,114],[52,126],[52,191],[62,113],[62,83],[61,140],[53,162],[53,46],[53,45],[55,172],[53,112],[55,250],[63,241],[63,219],[72,196],[72,233],[74,194],[74,65],[66,235],[72,19],[74,216],[66,253],[74,23],[73,99],[67,110],[65,58],[73,177],[65,61],[75,146],[75,155],[67,63],[88,34],[80,170],[88,39],[82,200],[82,132],[82,10],[90,15],[88,152],[88,92],[80,219],[80,247],[90,244],[81,236],[81,66],[81,13],[91,3],[83,235],[81,118],[89,113],[81,147],[83,249],[91,179],[83,151],[76,76],[68,75],[76,35],[70,140],[78,39],[70,144],[78,212],[69,206],[69,229],[69,39],[79,193],[71,5],[69,52],[69,114],[92,200],[92,14],[84,235],[86,137],[86,67],[94,231],[92,112],[84,178],[94,121],[86,243],[93,163],[93,242],[85,29],[93,157],[87,252],[87,210],[95,115],[104,45],[104,195],[104,135],[106,74],[98,105],[96,185],[104,255],[106,220],[106,218],[106,62],[106,81],[106,49],[98,215],[97,204],[107,130],[107,227],[105,58],[97,158],[97,149],[97,117],[105,95],[105,55],[99,218],[112,2],[120,99],[112,79],[114,202],[122,173],[112,123],[122,20],[122,249],[122,211],[122,187],[121,226],[113,41],[123,103],[113,208],[121,57],[115,48],[115,185],[115,83],[115,255],[108,136],[100,9],[108,67],[102,6],[102,131],[100,176],[100,218],[110,159],[103,200],[111,238],[109,59],[111,210],[116,128],[124,171],[126,104],[126,2],[124,156],[116,54],[124,17],[126,222],[126,182],[118,219],[125,196],[125,138],[117,109],[119,136],[119,32],[119,65],[117,56],[117,190],[125,155],[119,87],[136,40],[128,172],[136,13],[136,103],[130,78],[138,161],[130,43],[128,24],[136,249],[128,157],[138,156],[130,49],[138,117],[130,151],[129,9],[129,235],[129,7],[139,40],[139,172],[131,46],[131,229],[129,80],[137,50],[139,122],[139,150],[131,125],[144,135],[154,252],[146,245],[145,170],[147,65],[147,37],[155,235],[153,52],[145,247],[155,218],[147,86],[132,66],[140,129],[140,79],[134,72],[134,166],[142,3],[134,227],[134,111],[142,175],[132,94],[132,119],[134,250],[142,30],[142,55],[135,10],[143,138],[143,38],[135,33],[135,13],[133,114],[135,62],[156,67],[158,97],[148,88],[148,248],[156,50],[148,118],[148,177],[148,221],[148,155],[156,219],[158,156],[158,210],[150,25],[158,177],[149,105],[159,109],[151,43],[149,182],[149,185],[157,61],[157,87],[168,236],[168,37],[162,172],[162,2],[170,102],[170,143],[170,231],[168,48],[168,122],[168,246],[168,147],[162,20],[170,52],[162,114],[170,242],[162,241],[161,64],[169,10],[161,38],[169,197],[169,207],[161,52],[169,18],[161,250],[171,152],[163,247],[176,6],[176,69],[184,141],[178,132],[184,240],[184,85],[178,118],[186,145],[178,113],[185,192],[185,66],[185,42],[179,140],[179,202],[187,102],[179,15],[177,218],[187,20],[187,246],[179,19],[164,104],[172,44],[172,161],[172,235],[172,199],[164,103],[166,192],[174,224],[166,35],[173,232],[165,204],[167,236],[173,124],[165,26],[165,145],[173,25],[165,151],[180,109],[190,203],[188,58],[188,245],[190,189],[190,243],[181,37],[181,143],[183,104],[191,228],[189,254],[189,157],[181,245],[181,243],[191,176],[183,90],[191,62],[183,57],[191,213],[183,29],[191,53],[183,127],[200,1],[192,165],[194,130],[200,189],[194,252],[202,145],[194,91],[201,68],[193,42],[195,192],[201,122],[193,185],[201,117],[193,247],[203,177],[208,108],[216,135],[208,175],[218,196],[210,12],[218,9],[208,48],[216,148],[208,58],[208,182],[208,117],[210,118],[218,93],[218,53],[210,23],[217,2],[211,232],[211,229],[209,154],[209,246],[209,81],[219,20],[211,62],[211,211],[196,96],[204,167],[198,66],[198,71],[206,231],[196,92],[204,29],[204,53],[198,188],[205,168],[197,12],[197,228],[197,194],[205,45],[205,89],[205,149],[197,147],[199,95],[212,197],[222,136],[214,36],[222,236],[214,226],[222,198],[222,35],[220,220],[220,26],[212,17],[222,84],[214,148],[222,157],[221,129],[213,165],[215,172],[215,102],[223,169],[213,220],[221,31],[223,240],[226,72],[226,232],[226,7],[224,93],[234,245],[235,38],[235,237],[225,82],[225,126],[233,219],[248,6],[240,238],[248,161],[250,0],[250,194],[240,155],[250,244],[250,60],[242,252],[242,189],[242,147],[241,96],[249,236],[241,70],[249,225],[243,72],[243,174],[243,193],[243,139],[243,167],[241,115],[241,151],[243,244],[251,50],[228,7],[230,77],[236,85],[237,192],[237,133],[239,162],[231,78],[229,213],[239,80],[244,34],[244,137],[244,41],[246,106],[254,11],[254,111],[244,149],[244,53],[244,31],[246,176],[245,232],[245,197],[253,35],[255,192],[247,204],[247,233],[245,188],[253,246],[245,217],[253,151],[253,63],[255,156],[255,90],[247,254],[255,17],[247,191]]
};
</script>
<script>
/*
By downloading, copying, installing or using the software you agree to this
license. If you do not agree to this license, do not download, install,
copy or use the software.
                          License Agreement
               For Open Source Computer Vision Library
                       (3-clause BSD License)
Copyright (C) 2013, OpenCV Foundation, all rights reserved.
Third party copyrights are property of their respective owners.
Redistribution and use in source and binary forms, with or without modification,
are permitted provided that the following conditions are met:
  * Redistributions of source code must retain the above copyright notice,
    this list of conditions and the following disclaimer.
  * Redistributions in binary form must reproduce the above copyright notice,
    this list of conditions and the following disclaimer in the documentation
    and/or other materials provided with the distribution.
  * Neither the names of the copyright holders nor the names of the contributors
    may be used to endorse or promote products derived from this software
    without specific prior written permission.
This software is provided by the copyright holders and contributors "as is" and
any express or implied warranties, including, but not limited to, the implied
warranties of merchantability and fitness for a particular purpose are
disclaimed. In no event shall copyright holders or contributors be liable for
any direct, indirect, incidental, special, exemplary, or consequential damages
(including, but not limited to, procurement of substitute goods or services;
loss of use, data, or profits; or business interruption) however caused
and on any theory of liability, whether in contract, strict liability,
or tort (including negligence or otherwise) arising in any way out of
the use of this software, even if advised of the possibility of such damage.
*/

//Dictionary extracted from https://github.com/opencv/opencv_contrib/blob/4.x/modules/aruco/src/predefined_dictionaries.hpp

var AR = this.AR || require('../aruco').AR;
AR.DICTIONARIES['ARUCO_5X5_1000'] = {
  nBits: 25,
  tau: null,
  codeList: [[162,217,94,0],[14,3,115,0],[215,135,110,1],[129,202,251,1],[215,90,146,0],[234,4,22,1],[105,235,246,0],[113,10,53,1],[134,176,153,0],[152,159,210,1],[158,119,1,1],[209,109,96,0],[243,21,136,1],[47,56,179,0],[254,126,84,0],[40,241,191,1],[75,211,172,0],[95,81,55,1],[123,38,226,0],[131,14,244,0],[150,237,58,1],[168,114,32,0],[181,134,80,1],[93,9,111,0],[206,104,17,1],[210,204,185,0],[225,231,69,1],[17,33,35,0],[29,203,57,0],[18,17,29,1],[19,155,183,0],[27,68,57,1],[32,104,103,0],[37,85,100,0],[35,33,221,0],[61,55,245,0],[76,197,86,0],[65,104,128,1],[77,86,142,1],[67,30,57,0],[86,148,18,1],[82,151,207,0],[108,36,251,1],[97,132,236,1],[109,63,24,1],[116,177,61,0],[116,220,203,1],[124,164,3,0],[122,200,146,1],[123,91,235,1],[141,172,114,0],[141,105,60,1],[143,28,5,1],[139,74,34,1],[151,253,165,0],[172,101,198,1],[172,195,248,0],[161,23,239,1],[167,9,19,1],[171,111,145,0],[185,237,248,1],[178,100,158,0],[190,93,195,0],[196,5,67,1],[200,163,238,1],[194,117,197,0],[198,194,214,1],[217,102,212,1],[221,94,185,1],[244,234,25,0],[243,178,148,0],[122,186,5,0],[216,141,41,1],[12,103,50,1],[21,89,12,1],[76,116,192,1],[84,3,14,0],[160,208,172,0],[194,152,166,0],[203,104,150,0],[253,105,209,0],[4,145,90,1],[12,222,112,0],[5,170,62,0],[1,99,183,1],[9,145,68,1],[9,105,83,1],[6,37,161,1],[3,61,226,1],[7,213,6,1],[15,143,170,0],[28,116,60,1],[25,29,145,1],[22,27,35,1],[22,210,141,1],[23,78,198,1],[19,226,177,0],[31,126,250,1],[41,15,112,0],[34,71,126,1],[42,23,192,1],[42,251,100,1],[35,240,4,0],[39,205,252,0],[35,106,172,0],[47,123,47,0],[52,144,196,0],[48,9,214,1],[52,94,16,1],[57,82,232,0],[50,0,113,0],[54,231,29,0],[68,138,4,1],[68,236,254,1],[69,31,114,1],[69,74,149,0],[70,19,190,1],[78,131,9,0],[71,114,153,1],[79,130,125,1],[92,55,141,1],[88,253,119,0],[81,183,248,0],[89,58,251,0],[90,153,153,0],[83,1,240,1],[83,204,103,1],[83,110,1,0],[91,37,175,1],[95,213,204,1],[101,102,66,1],[101,199,175,0],[102,55,81,0],[103,12,197,1],[112,150,93,1],[124,99,128,1],[121,171,169,0],[114,61,70,0],[115,229,178,1],[132,38,140,0],[137,241,1,0],[134,174,233,1],[138,35,249,1],[148,53,113,1],[156,69,27,0],[149,31,164,1],[150,141,144,0],[151,38,183,0],[155,55,103,0],[155,198,224,1],[160,154,110,1],[164,82,134,1],[168,176,133,1],[173,155,66,0],[175,240,88,1],[176,46,99,1],[176,15,24,0],[188,234,178,1],[190,196,76,1],[179,130,250,0],[179,88,60,1],[191,69,238,0],[191,86,51,1],[196,58,240,0],[204,233,131,0],[197,51,0,1],[205,34,99,1],[198,8,138,1],[198,148,63,0],[202,238,132,1],[207,167,18,1],[203,97,226,1],[208,2,233,0],[220,183,70,0],[217,139,132,1],[217,206,178,0],[210,153,64,1],[210,209,23,0],[222,90,110,1],[218,71,66,1],[219,60,16,0],[219,143,201,0],[232,24,227,1],[229,28,111,0],[225,174,56,1],[237,185,123,1],[233,224,50,0],[235,93,12,0],[239,249,157,0],[248,17,1,0],[248,7,211,0],[246,2,32,1],[246,27,95,1],[254,181,237,0],[250,51,56,1],[250,74,193,1],[247,47,112,1],[247,234,252,1],[255,24,148,1],[251,163,94,0],[104,184,47,0],[153,15,11,1],[153,216,38,1],[228,95,14,1],[29,16,110,1],[42,193,48,1],[52,65,99,1],[55,192,116,1],[63,53,203,1],[86,160,76,0],[87,56,57,1],[102,152,184,0],[115,165,23,0],[127,44,253,1],[139,71,233,0],[165,195,151,0],[169,169,235,0],[181,25,183,0],[178,218,153,1],[196,193,244,0],[202,185,30,0],[216,111,163,1],[223,141,142,0],[229,102,143,1],[237,71,26,1],[240,103,134,1],[4,41,238,1],[0,35,71,1],[0,162,251,0],[4,200,206,0],[0,210,225,1],[12,10,15,0],[8,139,198,0],[12,134,91,0],[5,129,253,0],[1,113,30,0],[1,194,21,1],[1,231,113,0],[9,41,191,0],[13,16,27,1],[13,5,24,0],[13,237,47,1],[13,102,222,0],[9,242,118,0],[2,208,130,1],[2,98,201,0],[6,243,169,0],[6,239,35,0],[14,62,18,0],[10,154,221,1],[10,97,109,1],[10,255,81,0],[7,230,114,1],[11,154,1,0],[15,208,142,0],[15,73,147,0],[15,247,123,0],[16,158,96,1],[16,81,237,0],[20,122,222,1],[28,133,62,1],[28,35,104,0],[24,199,52,0],[21,251,130,1],[17,78,147,1],[25,160,234,1],[18,24,76,0],[18,163,174,0],[30,172,60,0],[30,201,108,0],[30,233,163,1],[26,118,216,0],[19,182,7,1],[23,70,188,0],[31,21,121,0],[27,35,125,0],[27,191,146,0],[31,150,154,1],[27,72,235,0],[32,12,253,0],[32,23,86,0],[40,1,153,1],[44,50,55,1],[37,140,230,0],[33,30,140,0],[45,125,105,0],[41,192,73,0],[38,177,32,0],[38,128,28,1],[34,180,26,0],[38,42,68,1],[38,171,89,0],[38,201,132,0],[42,48,98,1],[46,50,173,0],[35,63,1,1],[35,131,80,0],[39,100,46,1],[39,212,176,1],[47,186,44,1],[43,38,186,1],[48,11,141,0],[52,38,146,1],[48,130,25,0],[48,123,44,1],[60,184,59,1],[60,38,15,1],[56,233,220,0],[60,192,247,0],[56,247,84,1],[49,5,180,1],[53,184,254,1],[53,178,211,1],[57,155,206,1],[57,109,46,0],[61,224,131,1],[57,244,208,0],[57,255,32,0],[57,199,136,1],[54,15,36,0],[50,30,213,0],[54,191,209,1],[54,70,235,0],[58,45,168,0],[58,147,187,0],[55,149,173,0],[55,4,147,0],[51,160,216,1],[55,67,167,0],[51,250,92,0],[63,131,110,0],[63,107,96,0],[64,225,205,0],[76,144,234,0],[72,154,105,1],[76,190,247,0],[72,235,138,1],[72,211,7,1],[76,90,152,1],[65,36,19,1],[77,11,248,0],[73,91,189,1],[70,141,101,0],[66,181,107,1],[70,92,131,0],[70,244,103,0],[70,121,187,0],[74,163,157,1],[78,65,78,1],[78,75,194,0],[67,137,211,1],[71,170,200,1],[67,59,19,0],[71,74,105,1],[79,22,235,1],[79,69,160,0],[80,145,108,1],[84,16,187,0],[80,90,77,1],[80,114,212,0],[84,234,241,1],[88,9,195,1],[92,89,121,0],[88,107,27,0],[81,52,246,1],[85,169,118,1],[85,151,183,1],[85,72,67,1],[81,203,28,0],[89,103,105,1],[89,87,155,0],[86,160,171,1],[82,76,88,0],[86,87,68,1],[94,1,56,0],[90,1,255,0],[90,53,19,1],[94,29,215,1],[94,146,70,1],[90,108,162,0],[87,57,5,0],[87,185,238,0],[83,27,44,1],[87,134,8,0],[87,179,31,1],[87,175,125,0],[83,240,235,0],[91,30,236,0],[95,6,166,1],[95,46,87,1],[91,89,192,0],[91,221,125,1],[91,78,47,0],[95,111,137,1],[91,99,218,0],[96,32,36,1],[100,167,30,1],[96,84,84,1],[104,166,103,0],[108,235,188,1],[105,70,205,1],[109,243,169,1],[109,94,31,0],[102,32,99,0],[102,219,83,1],[98,215,16,1],[106,165,84,1],[110,46,41,1],[103,54,146,0],[103,196,202,0],[99,83,34,1],[107,59,196,1],[111,22,80,1],[107,88,37,1],[111,99,213,1],[112,192,248,1],[116,215,208,0],[113,43,110,1],[113,121,27,1],[113,66,210,0],[113,99,253,0],[117,254,122,1],[125,152,140,0],[125,185,247,0],[125,19,147,1],[121,71,103,0],[125,223,195,0],[121,239,82,1],[114,0,182,0],[118,68,152,1],[118,122,66,0],[126,11,181,1],[115,58,225,1],[119,139,59,1],[119,93,234,0],[127,76,0,1],[123,117,224,1],[127,226,186,0],[128,176,67,1],[128,188,61,0],[128,50,88,0],[128,92,26,1],[132,251,36,0],[128,127,245,1],[136,45,197,1],[136,153,224,1],[136,25,149,0],[133,29,199,1],[129,187,135,0],[129,225,96,1],[133,126,33,1],[129,242,146,0],[137,61,108,1],[137,100,178,1],[141,212,30,1],[137,94,209,1],[138,4,172,0],[142,200,22,0],[142,242,252,1],[131,11,137,0],[135,43,109,0],[135,69,49,0],[131,108,120,1],[135,238,13,0],[139,177,43,1],[139,145,216,0],[139,89,102,0],[143,229,85,0],[143,243,101,1],[148,26,21,0],[144,225,167,0],[144,71,255,0],[156,188,213,0],[152,146,244,0],[156,83,168,1],[152,195,107,0],[152,114,63,1],[145,19,213,0],[149,191,251,0],[149,69,22,1],[149,238,216,0],[157,214,4,0],[157,98,112,0],[150,175,206,0],[150,186,24,1],[150,217,61,1],[158,33,46,0],[154,185,132,0],[154,129,79,1],[154,59,54,1],[158,195,37,0],[147,149,40,0],[151,50,46,1],[151,211,152,0],[155,157,163,1],[159,28,240,0],[159,51,82,1],[155,250,202,0],[159,250,148,0],[160,60,203,1],[164,168,105,0],[160,179,245,0],[164,106,191,0],[160,91,120,1],[168,104,152,1],[172,205,54,1],[172,220,121,1],[161,73,35,0],[161,67,217,0],[173,176,209,0],[169,155,28,1],[169,138,215,1],[173,84,106,1],[173,235,81,1],[166,29,142,0],[166,92,102,1],[174,188,36,0],[170,171,48,0],[174,204,216,0],[170,237,187,0],[174,227,205,1],[167,54,8,1],[163,236,229,0],[163,193,155,1],[167,250,58,0],[175,165,105,1],[175,200,189,1],[175,239,164,0],[171,103,246,0],[180,28,82,0],[180,63,68,1],[180,240,202,0],[184,24,45,0],[188,191,136,1],[184,142,4,1],[188,120,40,1],[184,200,67,1],[188,243,60,1],[181,19,12,0],[177,63,106,0],[177,101,123,1],[177,203,237,0],[177,194,103,1],[177,90,242,1],[181,238,31,1],[185,144,112,1],[185,163,64,1],[185,120,90,0],[185,247,203,0],[182,5,1,1],[178,255,194,0],[178,123,21,0],[178,110,90,1],[190,181,243,1],[186,167,161,0],[186,114,10,1],[179,48,64,0],[183,181,52,1],[183,105,76,0],[183,197,193,0],[179,87,222,0],[187,84,251,0],[187,202,108,1],[187,251,225,1],[191,246,134,1],[196,45,124,0],[200,28,52,0],[204,67,229,1],[197,53,174,1],[193,146,192,0],[197,35,247,0],[193,159,254,0],[193,84,97,0],[193,87,130,0],[193,199,55,1],[201,140,239,1],[205,240,111,0],[201,95,103,1],[201,119,241,0],[205,226,149,1],[198,191,7,1],[198,191,184,0],[198,219,201,1],[202,49,136,0],[206,222,45,1],[199,120,44,1],[203,171,75,1],[207,67,191,0],[208,174,86,1],[208,115,51,0],[216,20,152,0],[220,96,159,1],[213,117,88,0],[209,224,215,0],[213,251,177,0],[213,218,116,1],[221,60,116,1],[221,151,109,0],[217,27,49,0],[217,98,166,0],[210,171,124,1],[210,197,236,0],[210,202,106,0],[210,107,214,0],[222,155,52,0],[222,146,158,0],[218,96,216,1],[215,57,178,1],[215,95,38,0],[223,1,65,1],[223,121,15,1],[219,247,116,0],[224,67,79,1],[224,198,227,0],[236,56,189,1],[236,81,253,0],[229,141,36,0],[229,5,121,1],[225,78,248,0],[229,87,220,1],[225,247,242,1],[226,133,77,0],[226,24,26,0],[226,43,203,0],[230,236,2,0],[230,98,129,0],[234,38,64,0],[234,224,196,0],[234,114,148,1],[227,17,63,1],[231,11,230,1],[227,100,241,1],[231,250,226,1],[227,219,243,0],[239,135,98,0],[239,93,112,0],[235,102,14,0],[239,74,60,0],[240,178,33,1],[240,175,79,0],[244,159,60,1],[240,245,4,0],[240,242,120,0],[248,52,99,0],[252,219,143,0],[252,254,77,1],[253,176,69,1],[253,51,235,0],[249,196,217,1],[242,35,145,1],[246,210,251,1],[254,239,211,1],[243,176,58,1],[247,138,77,1],[243,143,157,1],[247,242,39,0],[255,189,133,1],[255,38,197,1],[251,224,97,0],[255,220,26,0],[25,248,99,1],[169,93,31,1],[0,184,72,1],[0,236,225,0],[8,97,102,0],[8,244,131,0],[12,248,157,0],[8,192,62,1],[1,57,192,0],[1,40,10,0],[1,190,179,1],[13,128,85,0],[13,175,99,1],[6,181,236,0],[2,153,54,1],[6,182,143,0],[6,125,64,1],[2,114,104,1],[6,203,237,1],[14,15,61,0],[14,213,203,0],[3,125,39,1],[3,233,143,0],[7,250,159,1],[11,76,16,0],[16,185,87,1],[16,22,41,0],[16,98,139,1],[24,157,182,0],[24,109,0,1],[28,118,42,0],[24,95,228,1],[28,66,22,0],[17,60,169,0],[17,152,57,1],[21,58,99,0],[21,18,117,1],[21,222,162,0],[21,106,24,1],[29,209,40,0],[29,113,148,1],[18,57,139,1],[18,5,152,0],[22,2,152,1],[26,52,127,1],[30,220,239,1],[30,112,115,0],[26,67,149,0],[26,126,27,1],[23,173,194,0],[19,25,222,1],[27,168,147,1],[27,147,73,1],[27,208,27,0],[31,66,219,1],[32,185,170,0],[36,196,186,0],[40,173,5,0],[44,35,100,1],[44,14,154,1],[44,81,3,1],[37,197,207,1],[37,200,211,1],[33,119,232,1],[34,141,218,1],[34,10,238,0],[46,134,44,0],[42,182,47,1],[39,60,45,0],[39,157,74,0],[39,155,7,1],[35,87,132,0],[35,78,67,1],[47,171,185,1],[48,176,46,1],[48,40,122,0],[52,253,160,1],[60,214,137,0],[56,126,182,0],[49,0,109,0],[49,23,219,1],[49,167,119,1],[61,128,10,1],[61,226,157,0],[54,106,119,1],[54,199,190,1],[62,187,41,0],[62,104,154,0],[62,95,2,1],[58,86,206,1],[62,95,252,0],[51,185,172,0],[51,84,174,0],[63,25,160,0],[59,173,97,1],[59,112,47,1],[59,235,58,1],[64,83,90,0],[65,152,22,0],[65,143,177,0],[69,217,33,1],[69,235,1,0],[73,157,82,0],[66,56,79,1],[74,166,163,1],[74,197,42,1],[74,200,115,0],[71,180,198,1],[67,147,93,0],[67,120,117,0],[79,58,175,1],[79,135,68,1],[79,135,223,0],[79,196,222,1],[84,31,71,0],[80,31,148,0],[92,145,67,0],[88,189,239,1],[92,221,7,1],[92,102,88,1],[92,219,50,1],[85,69,212,0],[81,68,62,0],[81,231,230,0],[89,11,167,0],[93,186,56,1],[93,166,55,1],[89,249,149,0],[93,255,236,0],[82,157,58,0],[86,58,151,0],[82,99,34,0],[82,203,49,1],[90,139,204,1],[83,33,106,0],[87,245,17,0],[95,220,33,0],[96,140,28,0],[96,162,213,1],[96,222,5,1],[108,76,110,0],[104,82,12,0],[101,59,167,0],[97,170,234,0],[101,113,110,1],[101,124,89,1],[105,131,46,1],[109,196,12,0],[109,210,20,1],[98,150,165,1],[98,117,38,1],[98,100,214,1],[98,91,220,1],[110,51,2,1],[110,90,137,0],[99,209,212,0],[99,75,129,1],[107,56,145,1],[107,122,42,0],[116,56,51,0],[112,6,44,0],[116,170,141,1],[116,76,143,0],[124,183,167,0],[120,3,22,1],[124,199,198,1],[117,182,4,1],[113,254,101,0],[113,79,154,1],[121,32,119,0],[125,121,205,0],[125,67,92,0],[125,127,59,0],[118,85,8,0],[122,152,199,0],[126,19,192,0],[126,94,89,1],[115,36,132,0],[115,46,39,1],[115,139,84,1],[132,4,34,0],[128,232,46,0],[128,237,48,0],[140,53,96,0],[140,120,240,1],[136,194,128,1],[129,26,100,1],[129,38,163,0],[133,154,140,1],[137,19,23,1],[130,9,37,0],[130,183,201,1],[142,185,191,1],[138,159,236,0],[142,228,226,0],[135,32,232,0],[135,205,96,1],[135,71,172,1],[139,10,91,0],[139,92,190,1],[143,213,180,0],[139,118,41,0],[148,51,175,0],[144,85,72,1],[156,62,39,0],[152,151,159,0],[152,88,144,1],[149,182,31,0],[145,64,55,0],[157,179,128,0],[153,65,137,1],[146,173,38,0],[146,101,228,1],[146,111,141,1],[150,94,153,0],[154,11,77,0],[154,221,17,0],[147,246,156,1],[159,52,189,1],[159,80,9,0],[160,153,27,1],[164,15,234,0],[160,15,83,1],[168,2,105,1],[172,27,205,1],[172,135,77,0],[172,118,200,0],[165,68,167,0],[161,244,92,0],[169,157,169,0],[169,135,255,0],[169,71,98,1],[166,129,114,1],[166,249,172,1],[162,196,38,0],[170,53,101,1],[170,168,102,0],[170,200,143,0],[167,110,148,1],[175,4,36,1],[176,65,44,0],[176,208,227,0],[176,237,129,1],[180,231,236,0],[184,160,236,1],[184,188,60,1],[177,102,224,1],[189,49,10,1],[189,63,186,1],[185,190,220,0],[178,58,240,1],[182,207,169,0],[186,35,226,1],[183,36,171,1],[183,41,251,0],[179,174,8,0],[183,86,202,1],[191,168,244,0],[191,148,18,1],[191,122,64,1],[196,133,200,0],[192,14,9,1],[192,112,254,0],[204,116,17,0],[193,8,90,1],[193,47,130,1],[193,35,120,0],[198,52,219,1],[198,164,244,1],[194,228,25,0],[195,29,35,0],[195,242,196,1],[199,95,223,0],[203,101,189,0],[203,199,15,1],[207,246,185,0],[212,84,239,0],[212,251,220,0],[220,232,84,0],[213,177,150,0],[209,159,7,1],[209,93,126,1],[217,164,134,1],[221,9,48,1],[217,180,57,1],[221,171,105,1],[217,203,66,0],[210,33,13,0],[214,73,4,0],[210,216,219,0],[218,63,69,1],[218,125,218,0],[218,211,230,0],[211,51,189,0],[215,225,237,1],[219,197,122,0],[224,128,59,1],[224,207,105,1],[228,71,48,1],[232,29,86,1],[232,243,72,1],[232,254,175,0],[236,231,159,0],[225,60,212,1],[229,204,106,1],[233,175,154,0],[227,0,237,0],[231,177,14,0],[227,192,126,0],[235,140,163,0],[235,159,109,1],[239,65,11,0],[239,194,195,0],[240,168,32,0],[244,25,211,0],[244,133,191,1],[240,106,204,0],[240,123,107,1],[244,251,170,0],[252,198,47,0],[248,111,16,0],[252,127,120,1],[241,171,217,0],[245,81,143,1],[241,248,166,1],[241,86,24,0],[253,132,196,0],[249,141,114,1],[253,15,85,1],[242,156,111,1],[246,136,24,1],[246,7,197,0],[242,65,215,0],[246,241,27,0],[242,230,203,1],[250,213,32,1],[254,67,233,0],[243,251,142,0],[255,187,218,0],[251,201,14,1]]
};
</script>
<script>
/*
By downloading, copying, installing or using the software you agree to this
license. If you do not agree to this license, do not download, install,
copy or use the software.
                          License Agreement
               For Open Source Computer Vision Library
                       (3-clause BSD License)
Copyright (C) 2013, OpenCV Foundation, all rights reserved.
Third party copyrights are property of their respective owners.
Redistribution and use in source and binary forms, with or without modification,
are permitted provided that the following conditions are met:
  * Redistributions of source code must retain the above copyright notice,
    this list of conditions and the following disclaimer.
  * Redistributions in binary form must reproduce the above copyright notice,
    this list of conditions and the following disclaimer in the documentation
    and/or other materials provided with the distribution.
  * Neither the names of the copyright holders nor the names of the contributors
    may be used to endorse or promote products derived from this software
    without specific prior written permission.
This software is provided by the copyright holders and contributors "as is" and
any express or implied warranties, including, but not limited to, the implied
warranties of merchantability and fitness for a particular purpose are
disclaimed. In no event shall copyright holders or contributors be liable for
any direct, indirect, incidental, special, exemplary, or consequential damages
(including, but not limited to, procurement of substitute goods or services;
loss of use, data, or profits; or business interruption) however caused
and on any theory of liability, whether in contract, strict liability,
or tort (including negligence or otherwise) arising in any way out of
the use of this software, even if advised of the possibility of such damage.
*/

//Dictionary extracted from https://github.com/opencv/opencv_contrib/blob/4.x/modules/aruco/src/predefined_dictionaries.hpp

var AR = this.AR || require('../aruco').AR;
AR.DICTIONARIES['ARUCO_6X6_1000'] = {
  nBits: 36,
  tau: null,
  codeList: [[30,61,216,42,6],[14,251,163,137,1],[21,144,126,172,13],[201,27,48,105,14],[214,7,214,225,5],[216,232,224,230,8],[66,104,180,31,5],[136,165,15,41,10],[48,125,82,79,13],[60,47,52,179,12],[69,223,199,78,3],[72,216,91,37,7],[113,5,88,252,6],[134,220,250,208,7],[141,114,169,63,6],[162,184,157,205,14],[9,253,30,156,4],[21,77,189,24,15],[48,10,49,14,2],[72,7,239,175,13],[86,223,17,219,6],[102,136,50,116,12],[118,232,203,120,1],[154,83,217,207,3],[169,203,132,2,4],[198,117,73,73,0],[193,210,136,148,1],[231,72,8,82,11],[234,47,202,132,8],[233,99,183,123,1],[250,54,101,42,15],[6,91,255,123,13],[5,65,215,45,6],[12,247,36,106,2],[19,56,163,158,11],[21,168,147,231,4],[58,65,126,233,14],[79,17,226,108,0],[83,13,182,210,0],[88,155,250,227,4],[100,9,232,160,11],[96,83,122,137,1],[97,89,6,155,10],[107,255,120,215,11],[112,173,150,164,15],[117,132,111,113,10],[122,149,25,47,12],[134,9,118,10,10],[138,45,68,195,15],[147,235,120,177,4],[152,141,168,77,4],[158,222,43,60,8],[165,41,224,123,8],[181,147,184,85,15],[183,248,228,38,15],[188,32,82,37,14],[192,68,135,118,5],[196,195,36,37,9],[197,169,27,216,13],[206,115,230,178,12],[205,12,166,39,2],[201,67,93,68,13],[207,190,128,243,4],[229,125,21,135,7],[239,198,133,142,9],[247,126,243,119,2],[44,228,63,37,4],[43,220,255,75,3],[55,199,221,189,10],[161,162,84,224,15],[169,130,193,187,5],[216,27,73,176,8],[3,88,41,248,6],[7,196,9,95,12],[15,226,102,23,11],[20,72,54,68,1],[16,173,95,251,7],[18,130,149,83,15],[22,225,49,132,12],[24,122,73,107,0],[26,232,134,17,2],[25,19,174,10,1],[27,103,181,161,7],[37,220,149,240,11],[40,137,97,247,6],[51,84,20,106,10],[49,193,108,31,7],[51,203,24,198,6],[62,207,228,144,15],[70,69,24,163,15],[68,186,112,182,7],[65,156,98,62,8],[72,209,145,74,1],[84,244,153,246,13],[87,90,156,129,3],[85,131,85,178,12],[87,183,118,16,15],[92,52,54,254,4],[92,72,252,119,14],[94,110,239,64,2],[95,35,59,111,15],[91,116,42,99,2],[101,15,163,58,14],[101,211,23,92,12],[106,156,36,90,14],[105,197,243,4,2],[105,210,72,78,10],[116,121,226,222,6],[114,207,35,234,11],[119,177,220,65,4],[126,12,7,33,7],[122,105,112,100,7],[120,178,216,112,7],[121,197,133,121,4],[134,111,89,252,6],[130,246,114,127,5],[133,78,47,65,4],[154,17,133,147,4],[156,113,96,201,7],[157,209,148,253,8],[162,30,18,227,8],[174,112,28,130,12],[173,1,33,156,1],[176,53,31,158,14],[182,74,216,13,4],[181,55,49,75,4],[190,170,199,227,11],[187,104,61,188,15],[198,114,247,44,1],[193,231,77,186,11],[203,85,238,89,13],[203,160,83,114,4],[208,9,15,207,1],[208,108,58,213,4],[211,241,32,87,4],[230,227,59,26,7],[227,83,62,164,10],[232,6,142,177,4],[236,7,192,89,7],[234,243,128,61,10],[246,59,39,216,8],[243,7,152,55,9],[254,75,186,155,9],[171,165,125,134,11],[192,209,98,90,11],[19,206,123,174,7],[78,129,253,97,7],[86,224,118,50,0],[106,112,138,84,0],[114,168,152,161,8],[129,93,66,248,0],[207,76,195,213,15],[214,187,101,134,4],[236,211,19,163,1],[245,33,245,32,7],[249,31,165,223,7],[0,36,244,122,7],[0,8,77,136,2],[4,60,194,242,9],[4,123,80,33,1],[6,122,228,193,13],[0,170,150,138,3],[4,209,56,233,4],[5,16,168,13,10],[1,64,176,0,7],[1,157,156,238,1],[8,16,87,227,11],[8,107,151,182,6],[14,232,184,96,10],[11,108,118,185,11],[15,220,185,140,11],[15,202,207,58,0],[20,36,159,217,8],[20,7,32,31,13],[21,9,16,213,7],[19,92,215,48,7],[17,71,154,187,6],[28,185,169,35,8],[28,221,7,118,6],[31,46,124,36,11],[25,102,66,71,7],[25,87,212,200,4],[31,168,244,240,4],[27,130,70,237,8],[27,174,225,15,14],[34,164,182,60,10],[34,191,144,18,15],[35,44,21,180,0],[37,90,169,102,12],[39,165,175,169,7],[37,244,14,66,5],[40,102,85,205,14],[44,66,126,14,0],[42,185,124,189,0],[41,70,225,210,3],[45,166,40,65,0],[43,251,32,154,6],[54,140,214,107,12],[52,135,119,124,7],[52,221,235,132,0],[55,145,247,111,1],[58,34,142,23,5],[62,19,189,64,8],[60,152,67,202,2],[57,88,157,23,9],[57,116,218,238,11],[63,109,188,115,1],[61,107,192,80,12],[57,171,39,73,7],[70,2,78,37,14],[70,130,186,11,12],[66,233,205,90,14],[68,201,183,179,15],[64,199,212,30,9],[70,210,180,204,14],[67,25,83,86,11],[65,34,230,221,9],[71,83,165,154,11],[78,30,241,224,8],[78,74,192,150,0],[78,95,170,6,15],[74,141,50,148,3],[73,21,148,179,9],[77,77,219,98,1],[75,167,97,232,1],[73,212,131,216,14],[86,41,14,246,12],[83,126,213,255,12],[85,245,167,175,10],[85,213,234,100,15],[88,27,171,29,10],[94,190,146,109,13],[95,16,249,155,5],[93,30,223,165,12],[95,113,141,240,2],[93,225,30,70,8],[96,51,187,36,7],[100,88,26,254,1],[99,200,221,167,6],[97,218,61,143,13],[110,58,34,175,10],[110,97,5,183,1],[106,137,169,232,12],[106,151,34,79,5],[107,18,195,128,1],[107,104,75,34,10],[111,148,193,87,9],[109,166,254,160,13],[111,234,202,69,7],[112,61,56,166,0],[118,108,53,231,8],[112,74,13,255,6],[117,120,169,200,0],[113,74,112,19,8],[117,127,140,187,9],[124,35,104,51,1],[124,181,167,211,1],[124,248,44,237,14],[127,36,226,52,15],[127,71,41,141,8],[134,216,3,209,9],[131,139,27,161,3],[135,162,121,197,9],[138,67,100,140,14],[136,147,59,76,8],[143,33,223,78,3],[141,132,53,114,9],[141,136,215,31,13],[137,159,120,252,13],[146,107,22,121,12],[148,142,34,241,2],[144,229,230,49,7],[150,216,133,42,1],[149,57,59,164,6],[149,60,251,77,13],[145,62,170,18,6],[151,111,90,175,9],[145,178,41,253,10],[145,211,250,118,1],[154,112,134,200,8],[152,142,205,3,1],[152,199,16,151,10],[157,203,235,70,6],[164,40,245,182,14],[163,55,241,121,3],[163,68,64,245,10],[161,127,173,133,8],[167,210,150,35,13],[168,69,112,43,11],[174,72,127,160,9],[172,79,182,214,8],[168,168,211,133,3],[169,139,10,203,8],[173,254,140,222,2],[180,239,46,46,14],[183,153,137,199,0],[190,12,162,14,12],[188,112,34,122,9],[190,188,47,145,10],[184,233,10,152,3],[189,10,48,236,8],[194,2,224,243,1],[194,107,50,227,7],[198,202,66,106,8],[199,30,238,104,14],[199,125,46,145,3],[206,60,32,116,2],[204,74,185,197,7],[206,247,99,220,13],[205,67,34,202,2],[207,183,204,29,0],[201,206,200,53,10],[207,243,75,113,3],[214,46,123,112,13],[212,23,75,59,4],[215,141,250,151,14],[209,216,245,85,1],[213,207,225,211,9],[218,22,168,204,9],[216,76,68,133,9],[220,217,114,142,13],[223,103,17,126,8],[219,153,125,230,7],[221,171,142,49,14],[224,25,8,76,13],[230,54,218,82,1],[226,172,199,155,0],[228,141,33,98,0],[226,254,208,197,1],[225,58,125,2,10],[231,208,91,142,5],[236,48,156,107,5],[236,170,73,210,0],[238,179,122,196,6],[232,224,103,46,2],[234,229,213,36,12],[237,107,28,44,2],[235,200,175,29,6],[242,5,98,212,5],[246,25,188,251,2],[246,163,92,109,11],[244,241,189,15,0],[241,106,155,67,5],[241,178,145,41,14],[250,84,91,243,5],[254,110,134,124,6],[249,13,185,67,2],[249,105,102,43,13],[251,65,203,72,4],[253,87,191,152,5],[251,152,144,126,6],[255,234,33,198,3],[163,165,111,69,0],[161,152,104,48,2],[15,55,131,43,0],[38,236,72,39,2],[65,152,184,168,15],[78,181,67,138,4],[99,197,227,123,10],[110,89,221,230,12],[128,212,89,240,8],[152,8,136,159,13],[163,6,103,166,15],[2,25,166,20,7],[2,21,202,78,2],[0,104,204,57,9],[0,161,19,254,8],[2,185,86,117,5],[2,198,187,83,2],[2,243,31,29,9],[7,42,193,126,3],[7,55,141,151,2],[1,111,31,231,5],[1,119,48,21,5],[7,149,114,65,10],[7,200,163,134,14],[5,254,251,247,9],[12,21,243,16,1],[10,68,98,226,14],[8,94,55,238,9],[8,82,222,18,13],[12,102,136,3,9],[8,140,186,71,15],[12,172,39,30,5],[8,179,56,11,15],[12,162,165,217,4],[8,227,82,192,1],[14,255,68,245,14],[14,255,93,234,11],[11,52,109,201,14],[13,9,254,187,3],[15,16,170,146,6],[13,31,101,167,14],[15,177,95,160,0],[13,162,5,35,3],[13,175,35,219,11],[11,240,165,238,4],[13,200,153,251,14],[15,253,48,39,7],[11,199,93,86,2],[18,47,163,1,13],[18,117,72,114,5],[16,79,174,98,7],[16,140,138,232,11],[16,243,244,46,14],[19,55,238,112,2],[23,11,35,235,0],[21,2,111,27,11],[17,161,171,203,2],[19,166,74,200,13],[23,142,53,205,3],[21,139,229,157,12],[23,166,249,125,4],[21,220,164,180,4],[17,223,5,67,12],[21,210,1,147,5],[24,31,173,250,10],[28,64,14,171,13],[30,76,93,61,2],[24,111,246,127,9],[24,87,52,184,15],[30,86,137,227,4],[26,149,209,132,5],[24,167,255,2,10],[24,158,177,201,14],[28,178,10,96,10],[28,146,53,136,1],[28,147,183,214,13],[26,202,188,88,1],[28,226,172,181,8],[27,121,237,6,4],[31,106,57,19,2],[29,152,56,117,0],[32,13,193,3,15],[38,53,212,232,0],[38,117,44,47,8],[32,83,133,143,6],[34,136,31,122,3],[39,44,250,229,5],[33,107,76,67,11],[37,188,103,11,10],[33,163,233,176,14],[33,150,242,145,15],[39,162,43,140,10],[39,159,72,50,8],[35,226,188,201,7],[33,194,87,244,1],[39,207,186,248,11],[42,47,189,228,11],[42,84,58,140,12],[42,209,187,151,15],[40,255,58,99,1],[43,84,197,185,8],[45,97,175,26,10],[43,188,219,62,6],[45,159,154,13,2],[47,187,114,106,3],[43,217,204,255,7],[41,198,223,142,12],[52,12,63,195,5],[48,3,27,40,14],[48,113,29,236,3],[52,76,222,162,10],[50,122,138,139,12],[54,87,99,215,2],[52,141,50,170,6],[54,129,250,177,1],[54,153,111,21,13],[50,204,108,49,14],[54,224,7,77,4],[51,64,141,156,5],[51,125,174,182,10],[49,94,255,61,1],[53,164,249,40,11],[51,134,161,198,4],[53,232,26,158,12],[55,216,88,186,3],[56,21,51,89,12],[56,27,98,106,12],[58,54,80,219,10],[56,136,209,242,9],[58,204,141,200,2],[60,252,249,7,11],[60,246,137,57,12],[59,15,174,199,9],[61,11,95,245,6],[57,73,131,170,6],[61,92,175,229,6],[59,111,209,254,2],[61,114,229,206,7],[59,165,24,48,4],[59,215,215,116,14],[66,21,7,134,1],[68,42,51,204,5],[64,105,62,32,12],[68,76,84,241,12],[64,78,207,5,5],[64,223,74,196,6],[70,218,103,26,14],[67,32,239,178,13],[65,99,121,242,7],[71,127,169,44,10],[67,168,36,115,10],[69,174,2,166,1],[72,29,125,107,6],[72,68,41,14,4],[76,93,176,242,6],[72,79,166,76,0],[72,129,242,45,11],[72,140,105,154,11],[76,230,39,197,2],[79,61,163,205,7],[73,73,253,184,8],[77,89,111,25,7],[79,79,213,39,11],[75,148,100,228,11],[77,160,106,169,14],[75,146,209,251,2],[79,237,128,190,11],[73,250,110,175,3],[84,32,172,167,7],[84,25,164,142,8],[86,116,218,31,8],[82,70,69,212,11],[80,153,112,192,3],[82,162,196,106,5],[80,232,170,66,4],[82,242,173,89,8],[82,218,235,246,10],[85,46,248,226,2],[81,65,96,182,2],[85,104,6,21,8],[83,74,126,75,13],[83,107,211,224,11],[87,114,130,210,7],[87,129,213,88,2],[87,164,195,74,8],[81,151,175,148,8],[87,143,23,115,11],[85,194,224,207,0],[87,246,164,229,1],[92,5,94,2,5],[94,56,204,77,0],[94,101,102,31,5],[90,165,235,123,5],[94,173,81,224,13],[88,179,133,252,1],[90,197,248,110,0],[88,241,107,96,0],[91,48,177,32,8],[95,52,239,231,11],[89,64,115,102,9],[93,105,19,173,1],[89,82,185,227,11],[93,70,244,172,2],[95,128,157,46,8],[95,224,251,80,14],[95,235,211,215,0],[100,105,134,115,5],[96,188,232,205,8],[100,158,227,5,6],[98,212,165,37,13],[98,246,143,142,3],[101,96,72,36,7],[99,180,12,145,8],[99,159,233,153,13],[101,237,229,156,7],[103,235,231,112,4],[106,1,200,157,4],[104,61,242,11,0],[104,24,102,125,13],[108,84,97,80,15],[104,75,24,245,13],[104,79,21,129,0],[110,110,244,89,0],[110,152,128,38,5],[110,144,99,51,3],[110,241,228,10,7],[108,195,36,252,0],[105,0,81,91,15],[107,64,14,250,12],[107,124,181,68,7],[105,172,245,202,2],[105,167,102,247,12],[109,235,50,140,11],[116,23,252,110,12],[112,97,170,185,4],[116,67,17,82,1],[112,185,187,138,9],[118,148,62,229,4],[118,188,96,18,9],[112,155,7,165,4],[116,139,191,1,3],[114,248,93,79,11],[118,211,218,167,15],[117,36,208,249,9],[117,60,188,48,6],[119,3,201,213,15],[113,69,59,42,5],[115,108,25,223,1],[113,72,238,44,10],[115,111,34,124,0],[115,145,99,174,14],[117,131,158,142,9],[119,191,100,123,6],[115,229,189,18,10],[115,207,104,128,3],[113,247,74,10,0],[120,45,207,39,6],[124,2,58,157,7],[122,92,206,58,4],[122,114,16,7,7],[126,178,36,208,11],[120,253,197,213,2],[126,232,117,158,9],[123,28,43,68,14],[127,4,160,250,2],[123,39,78,235,3],[125,38,127,122,1],[127,50,169,94,10],[121,180,170,170,7],[125,176,215,37,3],[127,147,79,12,2],[125,252,16,66,2],[125,213,216,211,15],[128,56,32,103,11],[132,17,185,214,3],[128,3,252,100,10],[130,59,15,187,10],[134,42,167,117,10],[132,27,89,75,7],[130,68,49,200,10],[130,89,216,117,3],[132,72,31,220,14],[130,181,229,107,4],[128,183,10,183,0],[134,178,80,25,10],[128,204,47,123,8],[134,253,182,100,8],[129,121,60,62,9],[133,96,132,133,11],[131,98,22,146,5],[131,128,229,221,15],[135,160,76,203,2],[135,184,138,180,13],[142,2,6,56,4],[140,54,125,172,7],[140,65,233,44,2],[140,152,59,175,12],[136,244,107,79,11],[143,44,197,204,4],[141,55,126,115,3],[139,69,79,63,7],[141,86,37,150,0],[139,191,24,57,2],[141,166,67,9,4],[141,208,202,166,8],[139,246,152,79,4],[144,18,153,165,4],[150,46,4,135,5],[146,92,163,212,0],[146,133,143,119,10],[148,169,61,69,10],[145,32,243,51,2],[145,39,109,79,3],[151,51,253,233,10],[151,72,243,129,3],[151,159,160,6,9],[147,208,63,215,12],[149,252,208,110,0],[147,195,178,11,1],[145,195,66,1,14],[158,10,212,208,9],[158,62,24,70,8],[154,97,122,220,9],[152,200,135,101,13],[152,193,223,48,9],[158,249,40,250,12],[158,240,171,22,1],[152,251,117,9,13],[159,32,1,53,4],[153,18,120,7,12],[155,131,245,126,11],[153,249,200,173,5],[157,228,46,236,2],[155,219,144,210,3],[159,254,132,153,15],[162,66,140,215,9],[164,205,25,53,7],[166,213,162,25,0],[160,223,192,176,6],[163,49,180,144,4],[167,32,134,58,15],[167,56,45,40,13],[163,63,204,220,14],[165,62,179,132,11],[161,112,26,189,7],[167,103,101,55,9],[165,123,102,174,4],[161,213,29,147,2],[163,248,233,155,14],[165,211,131,218,3],[165,214,235,188,6],[170,38,227,151,9],[174,30,201,63,12],[172,119,184,237,2],[170,169,238,77,15],[170,128,121,170,6],[174,194,96,202,1],[169,58,152,98,11],[171,18,81,200,12],[173,102,219,216,13],[173,82,221,74,1],[169,182,113,16,8],[173,186,226,53,0],[173,151,65,223,12],[171,243,182,44,7],[182,34,108,113,12],[180,30,37,122,7],[182,55,195,138,3],[176,76,212,55,0],[178,127,139,5,3],[176,173,216,34,5],[180,155,130,43,11],[176,211,78,194,3],[177,61,126,195,14],[177,6,164,99,14],[179,43,116,63,14],[183,31,214,70,15],[177,110,241,244,5],[177,126,83,138,14],[183,98,223,55,7],[177,169,248,148,9],[179,183,217,210,4],[179,238,187,76,6],[184,44,165,82,4],[184,20,13,235,15],[188,25,220,199,7],[188,84,38,185,6],[190,103,55,196,5],[184,250,232,211,5],[190,194,26,55,8],[187,24,207,164,11],[189,1,126,246,13],[189,34,47,210,7],[189,2,85,133,5],[185,114,78,96,5],[189,119,92,22,15],[185,136,172,46,1],[191,160,38,103,5],[185,130,150,168,6],[189,135,23,24,10],[191,190,239,45,7],[189,250,159,0,7],[194,112,53,187,8],[196,108,5,172,13],[196,121,84,220,3],[194,106,81,13,8],[198,164,159,104,4],[192,158,44,235,4],[198,146,33,73,13],[196,186,131,207,8],[198,231,133,67,11],[198,215,175,70,4],[197,54,85,77,11],[195,147,255,13,7],[193,245,112,165,10],[204,57,113,197,0],[200,2,137,73,2],[200,124,100,74,5],[202,103,225,13,7],[200,153,231,66,2],[200,170,178,16,5],[204,166,213,159,3],[202,229,134,251,14],[202,217,124,49,15],[206,228,202,14,6],[203,45,164,50,12],[203,87,214,130,2],[201,144,33,177,0],[201,130,95,176,10],[203,158,212,36,7],[205,134,171,157,13],[201,201,176,119,5],[201,250,31,99,2],[203,247,64,6,9],[205,218,13,28,15],[208,11,130,83,15],[212,59,207,214,15],[214,98,171,209,11],[212,102,200,58,15],[209,32,28,120,10],[211,57,65,195,9],[209,7,160,253,4],[209,149,58,14,2],[215,189,66,29,13],[215,192,166,80,13],[215,229,141,245,12],[215,197,83,246,7],[213,254,112,184,8],[216,12,185,190,6],[222,52,186,37,6],[220,14,198,139,14],[222,3,247,164,11],[218,93,11,138,2],[216,113,249,127,15],[220,189,130,231,2],[220,176,90,229,5],[218,147,222,80,0],[218,183,241,191,8],[222,159,2,50,14],[218,196,13,85,0],[220,197,171,128,14],[218,194,178,58,10],[218,218,88,253,0],[217,37,142,168,1],[221,5,118,59,14],[221,46,153,8,12],[217,85,104,199,5],[219,80,109,76,3],[223,104,170,56,8],[219,66,135,167,5],[219,129,40,179,13],[217,163,194,250,13],[221,179,56,211,8],[217,202,123,155,1],[219,246,158,176,7],[226,8,108,175,8],[224,27,171,150,4],[224,72,115,243,0],[228,117,169,91,14],[230,128,236,116,9],[226,175,118,72,7],[224,162,200,17,13],[226,203,113,80,12],[224,210,73,197,15],[225,12,194,130,9],[225,127,68,52,3],[231,173,69,177,14],[225,182,90,159,9],[231,252,32,65,12],[238,51,65,56,1],[238,124,54,51,4],[236,112,123,248,10],[232,123,59,230,14],[232,149,232,57,1],[238,172,9,125,5],[236,161,201,55,4],[232,151,189,197,5],[232,204,18,29,0],[238,193,29,105,8],[237,7,255,219,10],[237,105,243,54,11],[237,118,20,181,12],[239,132,33,209,7],[235,245,218,120,2],[233,249,229,214,13],[235,211,15,145,9],[233,219,241,32,9],[244,41,139,109,8],[246,10,52,34,5],[244,88,85,155,1],[242,118,55,97,3],[244,75,10,224,6],[246,110,129,75,12],[246,67,29,76,6],[244,87,34,238,1],[244,153,83,229,11],[240,252,47,27,5],[247,9,30,9,12],[247,38,87,194,0],[241,133,27,198,13],[243,136,98,232,1],[247,169,183,234,6],[247,138,138,92,2],[243,237,194,21,2],[245,245,148,242,4],[248,15,62,15,4],[252,190,99,125,14],[248,237,33,73,11],[250,216,194,128,14],[254,229,5,156,6],[254,196,253,27,8],[250,210,225,31,4],[252,195,230,115,2],[249,63,162,110,11],[251,86,194,94,3],[255,78,140,162,15],[255,79,112,226,4],[249,177,42,52,9],[255,135,146,120,1],[249,195,188,9,10],[255,202,25,209,12],[255,239,23,165,10],[253,254,218,140,1],[6,66,233,9,7],[3,36,36,70,13],[7,94,92,135,12],[7,136,66,250,6],[10,7,178,27,11],[16,148,220,241,14],[22,162,90,176,15],[16,253,203,109,14],[17,52,172,162,12],[17,166,62,16,1],[30,88,44,226,2],[24,99,58,139,0],[26,99,1,47,13],[26,241,71,206,15],[25,108,177,139,1],[29,149,207,92,12],[25,158,56,146,2],[31,252,86,35,10],[36,27,41,179,3],[38,231,136,133,0],[33,7,54,188,1],[40,77,70,86,10],[46,236,227,69,8],[45,79,225,77,4],[45,138,40,60,7],[52,248,62,55,1],[56,99,93,125,8],[63,162,28,196,12],[66,221,151,174,14],[68,223,18,214,11],[65,58,205,236,8],[65,192,219,73,4],[76,180,0,200,13],[73,35,72,149,2],[82,55,185,92,6],[82,81,56,221,10],[94,113,146,65,3],[92,178,113,235,13],[91,238,55,54,6],[96,5,132,21,2],[100,8,128,51,8],[110,40,135,140,3],[108,85,84,181,7],[104,186,254,70,1],[104,179,85,202,7],[117,156,155,102,9],[124,11,200,10,0],[126,89,104,196,9],[120,111,61,52,5],[120,193,191,255,10],[122,218,185,69,10],[128,60,123,156,0],[135,20,88,249,7],[131,27,5,165,13],[136,59,180,103,4],[140,169,136,156,0],[142,177,3,26,11],[143,39,191,54,4],[143,22,179,202,0],[148,24,222,74,0],[147,69,36,197,0],[156,253,156,216,5],[155,34,55,120,13],[153,250,163,209,6],[162,159,28,84,3],[172,79,91,26,11],[172,191,109,54,6],[169,185,76,64,8],[182,40,233,2,12],[180,109,218,222,0],[178,110,246,10,1],[179,37,153,105,14],[179,80,40,17,5],[190,28,27,59,6],[188,127,85,99,14],[188,175,230,141,5],[189,37,146,140,4],[196,27,214,183,1],[198,99,190,252,14],[198,86,130,19,13],[198,139,73,36,10],[193,61,206,190,2],[197,25,109,109,1],[199,77,61,239,11],[193,90,43,220,9],[202,35,114,33,12],[207,199,244,213,9],[208,49,39,226,6],[212,119,84,14,0],[209,134,49,90,2],[219,76,100,122,11],[219,132,135,144,8],[223,222,6,112,0],[226,41,186,96,0],[225,64,224,141,6],[225,154,144,165,2],[231,242,192,250,9],[238,173,190,131,8],[240,28,242,124,1],[247,101,168,38,4],[247,236,195,164,13],[248,45,84,113,4],[254,133,143,205,11],[248,227,91,11,6],[254,214,62,31,15]]
};
</script>
<script>
'use strict';
(() => {
  const video=$('markerVideo'), canvas=$('markerCanvas');
  const ctx=canvas.getContext('2d',{willReadFrequently:true});
  let stream=null, timer=null, generation=0, detector=null;
  function status(text){$('scanStatus').textContent=text;}
  function clear(){ $('markerResults').replaceChildren(); }
  function configure(){
    const [bits,count]=$('dictionary').value.split(',').map(Number);
    const source=AR.DICTIONARIES[`ARUCO_${bits}X${bits}_1000`];
    // Exact code matching avoids guessing IDs from damaged/wrong-dictionary markers.
    AR.DICTIONARIES.KENNY={nBits:source.nBits,tau:1,codeList:source.codeList.slice(0,count)};
    detector=new AR.Detector({dictionaryName:'KENNY',maxHammingDistance:1});
    clear();
  }
  function stop(text='Camera stopped. Results cleared.'){
    ++generation;clearTimeout(timer);timer=null;
    if(stream)stream.getTracks().forEach(track=>track.stop());
    stream=null;video.srcObject=null;scannerBusy=false;
    $('cameraStart').disabled=false;$('cameraStop').disabled=true;
    clear();ctx.clearRect(0,0,canvas.width,canvas.height);buttons();status(text);
  }
  function detect(source,width,height){
    const scale=Math.min(1,640/Math.max(width,height));
    canvas.width=Math.round(width*scale);canvas.height=Math.round(height*scale);
    ctx.drawImage(source,0,0,canvas.width,canvas.height);
    const markers=detector.detect(ctx.getImageData(0,0,canvas.width,canvas.height));
    clear();
    const sx=width/canvas.width,sy=height/canvas.height;
    markers.forEach(marker=>{
      const corners=marker.corners.map(p=>({x:p.x*sx,y:p.y*sy}));
      // Intersect diagonals: this is the projected center even under perspective.
      const [a,b,c,d]=corners;
      const ux=c.x-a.x,uy=c.y-a.y,vx=d.x-b.x,vy=d.y-b.y;
      const denom=ux*vy-uy*vx;
      const t=((b.x-a.x)*vy-(b.y-a.y)*vx)/denom;
      const center={x:a.x+t*ux,y:a.y+t*uy};
      const row=document.createElement('div');row.className='marker-result';
      const title=document.createElement('strong');title.textContent=`ID / value: ${marker.id}`;
      const detail=document.createElement('div');
      detail.textContent=`Center: (${center.x.toFixed(1)}, ${center.y.toFixed(1)}) px · Corners: `+corners.map(p=>`(${p.x.toFixed(1)}, ${p.y.toFixed(1)})`).join(' · ');
      row.append(title,detail);$('markerResults').append(row);
      ctx.strokeStyle='#9ce4bc';ctx.lineWidth=3;ctx.beginPath();
      marker.corners.forEach((p,i)=>i?ctx.lineTo(p.x,p.y):ctx.moveTo(p.x,p.y));ctx.closePath();ctx.stroke();
      ctx.fillStyle='#ff7878';ctx.beginPath();ctx.arc(marker.corners[0].x,marker.corners[0].y,5,0,Math.PI*2);ctx.fill();
      ctx.fillStyle='#ff7878';ctx.font='bold 18px sans-serif';ctx.fillText(String(marker.id),marker.corners[0].x,marker.corners[0].y-8);
    });
    status(`${markers.length?markers.length+' marker(s) detected':'No markers detected — check dictionary, focus and lighting'}. Source ${width} × ${height} px; coordinates refer to this source image.`);
  }
  function frame(mine){
    if(mine!==generation||!stream)return;
    try{if(video.readyState>=2)detect(video,video.videoWidth,video.videoHeight);}
    catch(error){stop('Scan failed: '+error.message);return;}
    timer=setTimeout(()=>frame(mine),250);
  }
  $('cameraStart').addEventListener('click',async()=>{
    stop();disarm('Camera scanning. Driving stopped.');
    if(!window.isSecureContext||!navigator.mediaDevices?.getUserMedia){
      status('Live camera requires HTTPS. On http://192.168.4.1 use Take a photo / choose image below.');return;
    }
    scannerBusy=true;buttons();$('cameraStart').disabled=true;$('cameraStop').disabled=false;
    const mine=generation;status('Requesting rear camera permission…');
    try{
      const acquired=await navigator.mediaDevices.getUserMedia({audio:false,video:{facingMode:{ideal:'environment'},width:{ideal:640},height:{ideal:480}}});
      if(mine!==generation){acquired.getTracks().forEach(track=>track.stop());return;}
      stream=acquired;video.srcObject=stream;
      stream.getVideoTracks()[0].addEventListener('ended',()=>{if(mine===generation)stop('Camera disconnected.');});
      await video.play();frame(mine);
    }catch(error){if(mine===generation)stop('Camera unavailable: '+error.message+'. Use Take a photo / choose image.');}
  });
  $('cameraStop').addEventListener('click',()=>stop());
  $('markerPhoto').addEventListener('click',()=>{stop();disarm('Photo scanning. Driving stopped.');});
  $('markerPhoto').addEventListener('change',async event=>{
    const file=event.target.files[0];if(!file)return;
    stop();disarm('Photo scanning. Driving stopped.');scannerBusy=true;buttons();
    const mine=generation,url=URL.createObjectURL(file),image=new Image();
    try{
      image.src=url;await image.decode();
      if(mine===generation)detect(image,image.naturalWidth,image.naturalHeight);
    }catch(error){if(mine===generation){clear();status('Image could not be scanned. Choose a JPEG or PNG photo.');}}
    finally{URL.revokeObjectURL(url);event.target.value='';if(mine===generation){scannerBusy=false;buttons();}}
  });
  $('dictionary').addEventListener('change',()=>{stop('Dictionary changed. Start camera or choose another photo.');configure();});
  document.addEventListener('visibilitychange',()=>{if(document.hidden)stop('Camera stopped when page was hidden.');});
  window.addEventListener('pagehide',()=>stop());
  configure();
  if(!window.isSecureContext)status('On this HTTP page, use Take a photo / choose image. Live camera requires HTTPS.');
})();

</script>
</body></html>
)KENNYHTML";
